// VideoBitmap2Border.cpp : Defines the entry point for the console application.
//

/*
The video playback routines use the first characters in each segment, so 
we need to shuffle our border bitmap graphics around to accomodate this.

The first segment uses characters >00 to >5F, so we start encoding at >60. 
We get 4 rows solid, and then 4 rows of just 4 characters on each edge of the border.

The second segment uses characters >00 to >BF, so we start encoding at >C0. 
We have just 8 rows of 4 characters on each edge of the border.

The third segment uses characters >00 to >5F again, so we start encoding at >60. 
We get 4 rows of just 4 characters on each edge of the border, then 4 rows solid.

I'm just going to hand-encode the LCD characters in there...
*/

// This tool will reformat the input TI ARTIST image files (pattern and color)
// and output a binary screen image table ready to go

#include "stdafx.h"
#include <stdio.h>
#include <stdlib.h>
#include <errno.h>
#include <string.h>

unsigned char color[6144], pattern[6144], sit[768];
unsigned char col2[6144], pat2[6144];
unsigned char outbuf[8192];

const char *getColorName(int idx) {
    switch (idx) {
        case 0: return "transparent";
        case 1: return "black";
        case 2: return "med.green";
        case 3: return "lt.green";
        case 4: return "dk.blue";
        case 5: return "lt.blue";
        case 6: return "dk.red";
        case 7: return "cyan";
        case 8: return "med.red";
        case 9: return "lt.red";
        case 10: return "dk.yellow";
        case 11: return "lt.yellow";
        case 12: return "dk.green";
        case 13: return "magenta";
        case 14: return "grey";
        case 15: return "white";
        default: return "Whatchoo talkin' bout, Willis?";
    }
}

int main(int argc, char *argv[])
{
    char buf[128];
    int preferredCol = -1;

    if (argc < 3) {
        printf("VideoBitmap2Border <input> <output> [BORDER|CONTENT] [COL X]\n");
        printf("Input file is the TI ARTIST (with TIFILES or V9T9 header), no extension\n");
        printf("This program will add '.TIAC' and '.TIAP' extensions, so name that way.\n");
        printf("Will output 8k bin consisting of 3k color, 3k pattern, and 768 bytes SIT (and padding)\n");
        printf("'BORDER' skips the video characters, so only these characters are present:\n");
        printf(" segment 1: 0x60 to 0xff\n");
        printf(" segment 2: 0xC0 to 0xff\n");
        printf(" segment 3: 0x60 to 0xff\n");
        printf("'CONTENT' is just the video characters, so only these characters are present:\n");
        printf(" segment 1: 0x00 to 0x5f\n");
        printf(" segment 2: 0x00 to 0xbf\n");
        printf(" segment 3: 0x00 to 0x5f\n");
        printf("Note that this program is written for Dragon's Lair so also edits the characters\n");
        printf("down in the LED area of the border.\n");
        printf("'COL', if provided, tells the code to check the background colors and prefer\n");
        printf("the passed in setting if possible. (Must provide BORDER/CONTENT)\n");
        printf("If only the background can be mapped, then it will be.\n");
        return 1;
    }

    bool border=true;
    if (argc > 3) {
        if (0 == strcmp(argv[3], "BORDER")) {
            border=true;
        } else if (0 == strcmp(argv[3], "CONTENT")) {
            border=false;
        } else {
            printf("If you specify which data to emit, it must be BORDER or CONTENT\n");
            return 1;
        }
    }
    if (argc > 4) {
        if (0 == strcmp(argv[4], "COL")) {
            if (argc < 6) {
                printf("COL requires a parameter.\n");
                return 1;
            }
            preferredCol = atoi(argv[5]);
            if ((preferredCol < 0) || (preferredCol > 255)) {
                printf("BG color must be 0-255\n");
                return 1;
            }
            printf("Will prefer background be 0x%2X, %s on %s\n", preferredCol, getColorName(preferredCol>>4), getColorName(preferredCol&0x0f));
        }
    }

    sprintf(buf, "%s.TIAC", argv[1]);
    FILE *fp = fopen(buf, "rb");
    if (NULL == fp) {
        printf("Can't open %s, code %d\n", buf, errno);
        return 1;
    }
    fseek(fp, 128, SEEK_SET);
    fread(color, 1, 6144, fp);
    fclose(fp);

    sprintf(buf, "%s.TIAP", argv[1]);
    fp = fopen(buf, "rb");
    if (NULL == fp) {
        printf("Can't open %s, code %d\n", buf, errno);
        return 1;
    }
    fseek(fp, 128, SEEK_SET);
    fread(pattern, 1, 6144, fp);
    fclose(fp);

    // fix up the color table, if desired
    if (preferredCol != -1) {
        int invertedCol = ((preferredCol&0xf0)>>4) | ((preferredCol&0x0f)<<4);
        int solidcol = ((preferredCol&0x0f)<<4) | (preferredCol&0x0f);
        int preferredBG = (preferredCol&0x0f);
        for (int idx=0; idx<6144; ++idx) {
            // first, check for and leave alone exact match
            if (color[idx] == preferredCol) continue;

            // next, check for inverted colors
            if (color[idx] == invertedCol) {
                color[idx]=preferredCol;
                pattern[idx]^=0xff;
                continue;
            }

            // check for solid color matching BG
            if (color[idx] == solidcol) {
                color[idx] = preferredCol;      // we can promote it up
                pattern[idx] = 0;               // whichever pattern was, set to bg now
                continue;
            }

            // last test, check if the foreground color is the magic number
            if (((color[idx]&0xf0)>>4) == preferredBG) {
                // yep, so flip it. Even if it's solid it doesn't really matter
                color[idx] = ((color[idx]&0xf0)>>4) | ((color[idx]&0xf)<<4);
                pattern[idx] ^= 0xff;
            }
        }
    }

    // build the pattern table
    int idx;

    // first segment
    for (idx=0; idx<32*4; ++idx) {
        sit[idx]=idx+0x60;
    }
    for (idx=0; idx<4; ++idx) {
        for (int idx2=0; idx2<4; ++idx2) {
            sit[0x80+idx*32+idx2]=0xe0+idx2+idx*8;
            sit[0x80+idx*32+idx2+0x1c]=0xe4+idx2+idx*8;
        }
        for (int idx2=0; idx2<0x18; ++idx2) {
            sit[0x80+idx*32+idx2+4]=idx2+0x18*idx;
        }
    }

    // second segment
    for (idx=0; idx<8; ++idx) {
        for (int idx2=0; idx2<4; ++idx2) {
            sit[0x100+idx*32+idx2]=0xc0+idx2+idx*8;
            sit[0x100+idx*32+idx2+0x1c]=0xc4+idx2+idx*8;
        }
        for (int idx2=0; idx2<0x18; ++idx2) {
            sit[0x100+idx*32+idx2+4]=idx2+0x18*idx;
        }
    }

    // third segment
    for (idx=0; idx<4; ++idx) {
        for (int idx2=0; idx2<4; ++idx2) {
            sit[0x200+idx*32+idx2]=0x60+idx2+idx*8;
            sit[0x200+idx*32+idx2+0x1c]=0x64+idx2+idx*8;
        }
        for (int idx2=0; idx2<0x18; ++idx2) {
            sit[0x200+idx*32+idx2+4]=idx2+0x18*idx;
        }
    }
    for (idx=0; idx<32*4; ++idx) {
        sit[idx+0x280]=idx+0x80;
    }

    // Now we can use the SIT as a lookup table to remap the color and pattern tables
    for (idx=0; idx<768; idx++) {
        // the actual character layout is normally 0-767 (256 repeated 3 times)
        int srcoff = idx*8;         // src character offset
        int dstoff = sit[idx]*8+(256*8*(idx/256));    // dest character offset
        // move the color
        memcpy(&col2[dstoff], &color[srcoff], 8);
        // and the pattern
        memcpy(&pat2[dstoff], &pattern[srcoff], 8);
        //printf("%-3d - %02x -> %02x\n", idx, srcoff/8, dstoff/8);
    }

    // rework the LED area...
    // the score is located at 0x2a7 and 0x2c7
    // the lives are located at 0x2b7 and 0x2d7
    // By putting it here we still get the digits in the character set,
    // the top row starts at 0xA7 and the bottom at 0xC7
    // The space character (there are numerous ones) is at 0xB1
    // The image has 10 digits for score, but we only actually want 6, all zeroed
    for (int idx=0; idx<6; ++idx) {
        // zero digits
        sit[0x2a7+idx]=0xa7;
        sit[0x2c7+idx]=0xc7;
    }
    for (int idx=0; idx<4; ++idx) {
        // spaces
        sit[0x2a7+6+idx]=0xb1;
        sit[0x2c7+6+idx]=0xb1;
    }
    // set lives to zero too
    sit[0x2b7]=0xa7;
    sit[0x2d7]=0xc7;

    // write them out
    memset(outbuf,0,sizeof(outbuf));
    int bufpos=0;
    if (border) {
        // we don't write them all, we write the first & third block
        // from 0x60-0xff, second from 0xc0-0xff
        int sz=8*(256-0x60);
        memcpy(&outbuf[bufpos], &pat2[0x60*8], sz);     // 0x300
        bufpos+=sz;
            
        sz=8*(256-0xc0);
        memcpy(&outbuf[bufpos], &pat2[256*8+0xc0*8], sz);   // 0xE00
        bufpos+=sz;

        sz=8*(256-0x60);
        memcpy(&outbuf[bufpos], &pat2[512*8+0x60*8], sz);   // 0x1300
        bufpos+=sz;

        // we don't write them all, we write the first & third block
        // from 0x60-0xff, second from 0xc0-0xff
        sz=8*(256-0x60);
        memcpy(&outbuf[bufpos], &col2[0x60*8], sz);
        bufpos+=sz;

        sz=8*(256-0xc0);
        memcpy(&outbuf[bufpos], &col2[256*8+0xc0*8], sz);
        bufpos+=sz;

        sz=8*(256-0x60);
        memcpy(&outbuf[bufpos], &col2[512*8+0x60*8], sz);
        bufpos+=sz;
    } else {
        // video content
        // we write the chars the border doesn't
        int sz=8*0x60;
        memcpy(&outbuf[bufpos], &pat2[0], sz);
        bufpos+=sz;

        sz=8*0xc0;
        memcpy(&outbuf[bufpos], &pat2[256*8], sz);
        bufpos+=sz;

        sz=8*0x60;
        memcpy(&outbuf[bufpos], &pat2[512*8], sz);
        bufpos+=sz;

        // we write the chars the border doesn't
        sz=8*0x60;
        memcpy(&outbuf[bufpos], &col2[0], sz);
        bufpos+=sz;

        sz=8*0xc0;
        memcpy(&outbuf[bufpos], &col2[256*8], sz);
        bufpos+=sz;

        sz=8*0x60;
        memcpy(&outbuf[bufpos], &col2[512*8], sz);
        bufpos+=sz;
    }

    // and the SIT
    memcpy(&outbuf[bufpos], sit, 768);

    // now write it
    sprintf(buf, "%s", argv[2]);
    fp = fopen(buf, "wb");
    if (NULL == fp) {
        printf("Failed to write %s, code %d\n", buf, errno);
    } else {
        fwrite(outbuf, 1, 8192, fp);
        fclose(fp);
    }

    printf("** DONE **\n");

    return 0;
}


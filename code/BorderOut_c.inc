*
* Data file BorderOut_c.bin - Dec 09, 2018
*

BORDCOL
  BYTE >11,>11,>11,>11,>11,>11,>11,>11  * 00000000 ........ //
  BYTE >11,>11,>11,>11,>11,>81,>81,>11  * 00000008 ........ //
  BYTE >11,>11,>11,>81,>18,>18,>18,>11  * 00000010 ........ //
  BYTE >11,>11,>11,>11,>18,>18,>18,>81  * 00000018 ........ //
  BYTE >11,>11,>11,>11,>18,>18,>18,>18  * 00000020 ........ //
  BYTE >11,>11,>11,>11,>11,>11,>81,>81  * 00000028 ........ //
  BYTE >11,>11,>11,>11,>11,>11,>11,>18  * 00000030 ........ //
  BYTE >11,>11,>11,>11,>11,>11,>11,>11  * 00000038 ........ //
  BYTE >11,>11,>11,>11,>11,>11,>11,>81  * 00000040 ........ //
  BYTE >11,>11,>11,>11,>11,>11,>11,>18  * 00000048 ........ //
  BYTE >11,>11,>11,>11,>11,>11,>11,>11  * 00000050 ........ //
  BYTE >11,>11,>11,>11,>11,>11,>11,>81  * 00000058 ........ //
  BYTE >11,>11,>11,>11,>11,>11,>11,>81  * 00000060 ........ //
  BYTE >11,>11,>11,>11,>11,>11,>11,>11  * 00000068 ........ //
  BYTE >11,>11,>11,>11,>11,>11,>11,>81  * 00000070 ........ //
  BYTE >11,>11,>11,>11,>11,>11,>11,>11  * 00000078 ........ //
  BYTE >11,>11,>11,>11,>11,>11,>11,>81  * 00000080 ........ //
  BYTE >11,>11,>81,>81,>81,>11,>11,>81  * 00000088 ........ //
  BYTE >11,>11,>81,>81,>11,>11,>11,>81  * 00000090 ........ //
  BYTE >11,>11,>11,>11,>11,>11,>11,>18  * 00000098 ........ //
  BYTE >11,>11,>11,>11,>11,>11,>11,>11  * 000000A0 ........ //
  BYTE >11,>11,>11,>11,>11,>11,>11,>18  * 000000A8 ........ //
  BYTE >11,>11,>11,>11,>11,>11,>11,>81  * 000000B0 ........ //
  BYTE >11,>11,>11,>11,>11,>11,>11,>11  * 000000B8 ........ //
  BYTE >11,>11,>11,>11,>11,>11,>11,>18  * 000000C0 ........ //
  BYTE >11,>11,>11,>11,>11,>11,>11,>81  * 000000C8 ........ //
  BYTE >11,>11,>11,>11,>11,>11,>11,>18  * 000000D0 ........ //
  BYTE >11,>11,>11,>11,>11,>11,>11,>81  * 000000D8 ........ //
  BYTE >11,>11,>11,>11,>11,>11,>11,>81  * 000000E0 ........ //
  BYTE >11,>11,>11,>11,>11,>11,>11,>11  * 000000E8 ........ //
  BYTE >11,>11,>11,>11,>11,>11,>11,>11  * 000000F0 ........ //
  BYTE >11,>11,>11,>11,>11,>11,>11,>11  * 000000F8 ........ //
  BYTE >11,>11,>11,>11,>11,>11,>11,>11  * 00000100 ........ //
  BYTE >11,>11,>11,>11,>11,>11,>11,>11  * 00000108 ........ //
  BYTE >11,>11,>11,>11,>11,>11,>11,>11  * 00000110 ........ //
  BYTE >81,>18,>18,>18,>18,>18,>18,>18  * 00000118 ........ //
  BYTE >81,>81,>81,>81,>81,>81,>81,>81  * 00000120 ........ //
  BYTE >81,>81,>18,>18,>18,>18,>18,>18  * 00000128 ........ //
  BYTE >18,>18,>18,>18,>18,>18,>18,>18  * 00000130 ........ //
  BYTE >18,>18,>18,>18,>18,>18,>81,>81  * 00000138 ........ //
  BYTE >11,>11,>81,>81,>81,>81,>81,>18  * 00000140 ........ //
  BYTE >18,>18,>18,>18,>81,>81,>81,>81  * 00000148 ........ //
  BYTE >11,>11,>81,>81,>81,>18,>18,>18  * 00000150 ........ //
  BYTE >18,>18,>81,>81,>81,>81,>81,>81  * 00000158 ........ //
  BYTE >18,>18,>81,>11,>11,>11,>81,>18  * 00000160 ........ //
  BYTE >11,>81,>81,>81,>81,>81,>81,>18  * 00000168 ........ //
  BYTE >81,>18,>18,>18,>18,>18,>81,>81  * 00000170 ........ //
  BYTE >11,>81,>18,>18,>18,>18,>18,>18  * 00000178 ........ //
  BYTE >81,>11,>11,>81,>81,>81,>18,>18  * 00000180 ........ //
  BYTE >81,>81,>81,>81,>81,>81,>81,>81  * 00000188 ........ //
  BYTE >18,>18,>18,>18,>18,>18,>81,>81  * 00000190 ........ //
  BYTE >81,>81,>81,>11,>81,>81,>81,>18  * 00000198 ........ //
  BYTE >11,>81,>11,>11,>11,>11,>11,>11  * 000001A0 ........ //
  BYTE >81,>81,>81,>81,>81,>81,>81,>81  * 000001A8 ........ //
  BYTE >81,>81,>81,>81,>81,>81,>81,>81  * 000001B0 ........ //
  BYTE >11,>11,>11,>11,>11,>81,>81,>81  * 000001B8 ........ //
  BYTE >18,>81,>18,>81,>81,>81,>81,>81  * 000001C0 ........ //
  BYTE >81,>81,>81,>18,>18,>18,>18,>18  * 000001C8 ........ //
  BYTE >18,>18,>18,>18,>18,>18,>18,>18  * 000001D0 ........ //
  BYTE >81,>81,>81,>81,>81,>81,>81,>81  * 000001D8 ........ //
  BYTE >18,>81,>81,>81,>81,>81,>81,>18  * 000001E0 ........ //
  BYTE >81,>81,>18,>18,>18,>81,>81,>81  * 000001E8 ........ //
  BYTE >11,>11,>11,>11,>11,>11,>11,>11  * 000001F0 ........ //
  BYTE >11,>11,>11,>11,>11,>11,>11,>11  * 000001F8 ........ //
  BYTE >11,>11,>11,>11,>11,>11,>11,>11  * 00000200 ........ //
  BYTE >11,>11,>11,>11,>11,>11,>11,>11  * 00000208 ........ //
  BYTE >11,>11,>11,>11,>11,>11,>11,>11  * 00000210 ........ //
  BYTE >18,>1A,>1A,>1A,>1A,>1A,>1A,>A1  * 00000218 ........ //
  BYTE >81,>A1,>A1,>1A,>1A,>1A,>1A,>1A  * 00000220 ........ //
  BYTE >18,>1A,>A1,>A1,>A1,>11,>11,>11  * 00000228 ........ //
  BYTE >18,>1A,>1A,>1A,>1A,>1A,>1A,>11  * 00000230 ........ //
  BYTE >81,>1A,>1A,>1A,>1A,>1A,>A1,>A1  * 00000238 ........ //
  BYTE >1A,>1A,>1A,>1A,>1A,>1A,>A1,>A1  * 00000240 ........ //
  BYTE >A1,>1A,>A1,>A1,>A1,>11,>11,>11  * 00000248 ........ //
  BYTE >1A,>1A,>1A,>1A,>1A,>1A,>1A,>11  * 00000250 ........ //
  BYTE >A1,>A1,>1A,>1A,>1A,>1A,>A1,>11  * 00000258 ........ //
  BYTE >1A,>1A,>1A,>1A,>1A,>1A,>1A,>11  * 00000260 ........ //
  BYTE >1A,>1A,>1A,>1A,>A1,>A1,>11,>11  * 00000268 ........ //
  BYTE >11,>A1,>A1,>1A,>1A,>1A,>A1,>11  * 00000270 ........ //
  BYTE >1A,>1A,>1A,>A1,>A1,>A1,>1A,>11  * 00000278 ........ //
  BYTE >1A,>1A,>1A,>A1,>A1,>11,>11,>11  * 00000280 ........ //
  BYTE >A1,>A1,>A1,>A1,>A1,>A1,>11,>11  * 00000288 ........ //
  BYTE >11,>11,>A1,>A1,>1A,>1A,>1A,>11  * 00000290 ........ //
  BYTE >1A,>1A,>1A,>1A,>1A,>1A,>A1,>11  * 00000298 ........ //
  BYTE >11,>11,>A1,>A1,>11,>11,>11,>11  * 000002A0 ........ //
  BYTE >A1,>A1,>A1,>A1,>A1,>1A,>1A,>11  * 000002A8 ........ //
  BYTE >A1,>A1,>A1,>A1,>A1,>1A,>1A,>11  * 000002B0 ........ //
  BYTE >A1,>1A,>1A,>1A,>1A,>1A,>1A,>11  * 000002B8 ........ //
  BYTE >A1,>A1,>1A,>1A,>A1,>A1,>11,>11  * 000002C0 ........ //
  BYTE >1A,>1A,>1A,>1A,>1A,>1A,>1A,>11  * 000002C8 ........ //
  BYTE >1A,>1A,>1A,>1A,>1A,>1A,>1A,>11  * 000002D0 ........ //
  BYTE >A1,>A1,>A1,>A1,>A1,>A1,>A1,>11  * 000002D8 ........ //
  BYTE >1A,>1A,>1A,>A1,>A1,>A1,>A1,>11  * 000002E0 ........ //
  BYTE >11,>A1,>A1,>A1,>A1,>1A,>1A,>1A  * 000002E8 ........ //
  BYTE >11,>11,>11,>11,>11,>11,>11,>11  * 000002F0 ........ //
  BYTE >11,>11,>11,>11,>11,>11,>11,>11  * 000002F8 ........ //
  BYTE >11,>11,>11,>11,>11,>11,>11,>11  * 00000300 ........ //
  BYTE >11,>11,>11,>11,>11,>11,>11,>11  * 00000308 ........ //
  BYTE >11,>11,>11,>A1,>A1,>11,>11,>11  * 00000310 ........ //
  BYTE >A1,>1A,>1A,>1A,>A1,>11,>11,>F1  * 00000318 ........ //
  BYTE >A1,>A1,>A1,>11,>11,>11,>11,>1F  * 00000320 ........ //
  BYTE >11,>11,>11,>11,>11,>11,>11,>1F  * 00000328 ........ //
  BYTE >11,>11,>11,>11,>11,>11,>11,>1F  * 00000330 ........ //
  BYTE >A1,>11,>11,>11,>11,>11,>11,>1F  * 00000338 ........ //
  BYTE >1A,>1A,>1A,>11,>11,>11,>11,>1F  * 00000340 ........ //
  BYTE >11,>11,>11,>11,>11,>11,>11,>1F  * 00000348 ........ //
  BYTE >11,>11,>11,>11,>11,>11,>11,>1F  * 00000350 ........ //
  BYTE >11,>11,>11,>11,>11,>11,>11,>1F  * 00000358 ........ //
  BYTE >11,>11,>11,>11,>11,>11,>11,>1F  * 00000360 ........ //
  BYTE >11,>11,>11,>11,>11,>11,>11,>1F  * 00000368 ........ //
  BYTE >11,>11,>11,>11,>11,>11,>11,>1F  * 00000370 ........ //
  BYTE >11,>11,>11,>11,>11,>11,>11,>1F  * 00000378 ........ //
  BYTE >11,>11,>11,>11,>11,>11,>11,>1F  * 00000380 ........ //
  BYTE >11,>11,>11,>11,>11,>11,>11,>1F  * 00000388 ........ //
  BYTE >11,>11,>11,>11,>11,>11,>11,>1F  * 00000390 ........ //
  BYTE >11,>11,>11,>11,>11,>11,>11,>1F  * 00000398 ........ //
  BYTE >11,>11,>11,>11,>11,>11,>11,>1F  * 000003A0 ........ //
  BYTE >11,>11,>11,>11,>11,>11,>11,>1F  * 000003A8 ........ //
  BYTE >11,>11,>11,>11,>11,>11,>11,>1F  * 000003B0 ........ //
  BYTE >11,>11,>11,>11,>11,>11,>11,>1F  * 000003B8 ........ //
  BYTE >11,>11,>11,>11,>11,>11,>11,>1F  * 000003C0 ........ //
  BYTE >11,>11,>11,>11,>11,>11,>11,>1F  * 000003C8 ........ //
  BYTE >11,>11,>11,>11,>11,>11,>11,>1F  * 000003D0 ........ //
  BYTE >11,>11,>11,>11,>11,>11,>11,>1F  * 000003D8 ........ //
  BYTE >11,>11,>11,>11,>11,>11,>11,>F1  * 000003E0 ........ //
  BYTE >A1,>A1,>A1,>11,>11,>11,>11,>11  * 000003E8 ........ //
  BYTE >A1,>A1,>1A,>1A,>11,>11,>11,>11  * 000003F0 ........ //
  BYTE >11,>11,>11,>11,>11,>11,>11,>11  * 000003F8 ........ //
  BYTE >11,>11,>11,>11,>11,>11,>11,>11  * 00000400 ........ //
  BYTE >11,>11,>11,>11,>11,>11,>11,>11  * 00000408 ........ //
  BYTE >11,>11,>11,>11,>11,>11,>11,>11  * 00000410 ........ //
  BYTE >F1,>F1,>F1,>F1,>F1,>F1,>F1,>F1  * 00000418 ........ //
  BYTE >F1,>F1,>F1,>F1,>F1,>F1,>F1,>F1  * 00000420 ........ //
  BYTE >11,>11,>11,>11,>11,>11,>11,>11  * 00000428 ........ //
  BYTE >11,>11,>11,>11,>11,>11,>11,>11  * 00000430 ........ //
  BYTE >11,>11,>11,>11,>11,>11,>11,>11  * 00000438 ........ //
  BYTE >11,>11,>11,>11,>11,>11,>11,>11  * 00000440 ........ //
  BYTE >11,>11,>11,>11,>11,>11,>11,>11  * 00000448 ........ //
  BYTE >11,>11,>11,>11,>11,>11,>11,>11  * 00000450 ........ //
  BYTE >F1,>F1,>F1,>F1,>F1,>F1,>F1,>F1  * 00000458 ........ //
  BYTE >F1,>F1,>F1,>F1,>F1,>F1,>F1,>F1  * 00000460 ........ //
  BYTE >11,>11,>11,>11,>11,>11,>11,>11  * 00000468 ........ //
  BYTE >11,>11,>11,>11,>11,>11,>11,>11  * 00000470 ........ //
  BYTE >11,>11,>11,>11,>11,>11,>11,>11  * 00000478 ........ //
  BYTE >11,>11,>11,>11,>11,>11,>11,>11  * 00000480 ........ //
  BYTE >11,>11,>11,>11,>11,>11,>11,>11  * 00000488 ........ //
  BYTE >11,>11,>11,>11,>11,>11,>11,>11  * 00000490 ........ //
  BYTE >F1,>F1,>F1,>F1,>F1,>F1,>F1,>F1  * 00000498 ........ //
  BYTE >F1,>F1,>F1,>F1,>F1,>F1,>F1,>F1  * 000004A0 ........ //
  BYTE >11,>11,>11,>11,>11,>11,>11,>11  * 000004A8 ........ //
  BYTE >11,>11,>11,>11,>11,>11,>11,>11  * 000004B0 ........ //
  BYTE >11,>11,>11,>11,>11,>11,>11,>11  * 000004B8 ........ //
  BYTE >11,>11,>11,>11,>11,>11,>11,>11  * 000004C0 ........ //
  BYTE >11,>11,>11,>11,>11,>11,>11,>11  * 000004C8 ........ //
  BYTE >11,>11,>11,>11,>11,>11,>11,>11  * 000004D0 ........ //
  BYTE >F1,>F1,>F1,>F1,>F1,>F1,>F1,>F1  * 000004D8 ........ //
  BYTE >F1,>F1,>F1,>F1,>F1,>F1,>F1,>F1  * 000004E0 ........ //
  BYTE >11,>11,>11,>11,>11,>11,>11,>11  * 000004E8 ........ //
  BYTE >11,>11,>11,>11,>11,>11,>11,>11  * 000004F0 ........ //
  BYTE >11,>11,>11,>11,>11,>11,>11,>11  * 000004F8 ........ //
  BYTE >11,>11,>11,>11,>11,>11,>11,>11  * 00000500 ........ //
  BYTE >11,>11,>11,>11,>11,>11,>11,>11  * 00000508 ........ //
  BYTE >11,>11,>11,>11,>11,>11,>11,>11  * 00000510 ........ //
  BYTE >F1,>F1,>F1,>F1,>F1,>F1,>F1,>F1  * 00000518 ........ //
  BYTE >F1,>F1,>F1,>F1,>F1,>F1,>F1,>F1  * 00000520 ........ //
  BYTE >11,>11,>11,>11,>11,>11,>11,>11  * 00000528 ........ //
  BYTE >11,>11,>11,>11,>11,>11,>11,>11  * 00000530 ........ //
  BYTE >11,>11,>11,>11,>11,>11,>11,>11  * 00000538 ........ //
  BYTE >11,>11,>11,>11,>11,>11,>11,>11  * 00000540 ........ //
  BYTE >11,>11,>11,>11,>11,>11,>11,>11  * 00000548 ........ //
  BYTE >11,>11,>11,>11,>11,>11,>11,>11  * 00000550 ........ //
  BYTE >F1,>F1,>F1,>F1,>F1,>F1,>F1,>F1  * 00000558 ........ //
  BYTE >F1,>F1,>F1,>F1,>F1,>F1,>F1,>F1  * 00000560 ........ //
  BYTE >11,>11,>11,>11,>11,>11,>11,>11  * 00000568 ........ //
  BYTE >11,>11,>11,>11,>11,>11,>11,>11  * 00000570 ........ //
  BYTE >11,>11,>11,>11,>11,>11,>11,>11  * 00000578 ........ //
  BYTE >11,>11,>11,>11,>11,>11,>11,>11  * 00000580 ........ //
  BYTE >11,>11,>11,>11,>11,>11,>11,>11  * 00000588 ........ //
  BYTE >11,>11,>11,>11,>11,>11,>11,>11  * 00000590 ........ //
  BYTE >F1,>F1,>F1,>F1,>F1,>F1,>F1,>F1  * 00000598 ........ //
  BYTE >F1,>F1,>F1,>F1,>F1,>F1,>F1,>F1  * 000005A0 ........ //
  BYTE >11,>11,>11,>11,>11,>11,>B1,>FA  * 000005A8 ........ //
  BYTE >11,>11,>11,>11,>B1,>F1,>A1,>11  * 000005B0 ........ //
  BYTE >11,>11,>11,>11,>11,>11,>11,>11  * 000005B8 ........ //
  BYTE >11,>11,>11,>11,>11,>11,>11,>11  * 000005C0 ........ //
  BYTE >11,>11,>11,>11,>11,>11,>11,>11  * 000005C8 ........ //
  BYTE >11,>11,>11,>11,>11,>11,>11,>11  * 000005D0 ........ //
  BYTE >F1,>F1,>F1,>F1,>F1,>F1,>F1,>F1  * 000005D8 ........ //
  BYTE >F1,>1F,>1F,>1B,>1F,>B1,>F1,>F1  * 000005E0 ........ //
  BYTE >1F,>1F,>1F,>1F,>F1,>E1,>B1,>1A  * 000005E8 ........ //
  BYTE >11,>11,>11,>11,>11,>11,>11,>11  * 000005F0 ........ //
  BYTE >11,>11,>11,>11,>11,>11,>11,>11  * 000005F8 ........ //
  BYTE >11,>11,>11,>11,>11,>11,>11,>11  * 00000600 ........ //
  BYTE >11,>11,>11,>A1,>A1,>31,>C1,>31  * 00000608 .....1.1 //
  BYTE >11,>B1,>A1,>A1,>A1,>11,>11,>11  * 00000610 ........ //
  BYTE >B1,>B1,>F1,>F1,>F1,>F1,>F1,>F1  * 00000618 ........ //
  BYTE >F1,>F1,>F1,>F1,>F1,>F1,>F1,>F1  * 00000620 ........ //
  BYTE >B1,>B1,>B1,>B1,>B1,>B1,>B1,>B1  * 00000628 ........ //
  BYTE >11,>11,>A1,>B1,>B1,>B1,>B1,>1B  * 00000630 ........ //
  BYTE >11,>11,>11,>11,>11,>11,>11,>11  * 00000638 ........ //
  BYTE >11,>11,>B1,>11,>A1,>11,>C1,>B1  * 00000640 ........ //
  BYTE >A1,>11,>11,>11,>11,>11,>11,>11  * 00000648 ........ //
  BYTE >11,>31,>11,>A1,>B1,>A1,>11,>11  * 00000650 .1...... //
  BYTE >F1,>F1,>F1,>F1,>F1,>F1,>F1,>F1  * 00000658 ........ //
  BYTE >F1,>F1,>F1,>F1,>F1,>F1,>F1,>F1  * 00000660 ........ //
  BYTE >B1,>B1,>11,>11,>11,>11,>11,>11  * 00000668 ........ //
  BYTE >1B,>1B,>1B,>1A,>1B,>1B,>1A,>1B  * 00000670 ........ //
  BYTE >11,>11,>11,>11,>11,>11,>11,>11  * 00000678 ........ //
  BYTE >B1,>B1,>31,>31,>31,>31,>F1,>B1  * 00000680 ..1111.. //
  BYTE >11,>11,>11,>11,>11,>11,>11,>11  * 00000688 ........ //
  BYTE >B1,>A1,>C1,>11,>A1,>B1,>B1,>11  * 00000690 ........ //
  BYTE >F1,>F1,>F1,>F1,>F1,>F1,>1B,>AF  * 00000698 ........ //
  BYTE >F1,>F1,>F1,>F1,>F1,>F1,>F1,>F1  * 000006A0 ........ //
  BYTE >11,>11,>11,>11,>11,>11,>11,>11  * 000006A8 ........ //
  BYTE >1B,>1B,>1B,>1B,>1B,>1B,>1B,>A1  * 000006B0 ........ //
  BYTE >11,>11,>11,>11,>11,>11,>11,>11  * 000006B8 ........ //
  BYTE >B1,>A1,>11,>31,>C1,>31,>31,>B1  * 000006C0 ...1.11. //
  BYTE >11,>31,>F1,>11,>F1,>B1,>C1,>A1  * 000006C8 .1...... //
  BYTE >B1,>B1,>B1,>A1,>1B,>B1,>1A,>1B  * 000006D0 ........ //
  BYTE >FA,>FA,>FA,>FA,>FA,>FA,>FA,>AF  * 000006D8 ........ //
  BYTE >F1,>F1,>F1,>F1,>F1,>F1,>F1,>F1  * 000006E0 ........ //
  BYTE >11,>1F,>1F,>1E,>1F,>1F,>1F,>1F  * 000006E8 ........ //
  BYTE >1B,>1B,>FA,>1B,>1A,>1B,>B1,>1B  * 000006F0 ........ //
  BYTE >11,>11,>A1,>F1,>B1,>A1,>B1,>B1  * 000006F8 ........ //
  BYTE >B1,>A1,>A1,>11,>11,>11,>11,>11  * 00000700 ........ //
  BYTE >F1,>A1,>B1,>A1,>31,>31,>C1,>31  * 00000708 ....11.1 //
  BYTE >1B,>1B,>1A,>1B,>1A,>1B,>1A,>3B  * 00000710 .......; //
  BYTE >FA,>CF,>FA,>1B,>FA,>FA,>FA,>FA  * 00000718 ........ //
  BYTE >F1,>F1,>F1,>F1,>F1,>F1,>F1,>F1  * 00000720 ........ //
  BYTE >1F,>1F,>F1,>1B,>1B,>1B,>A1,>1B  * 00000728 ........ //
  BYTE >B1,>1B,>F6,>1B,>1F,>1F,>EF,>1F  * 00000730 ........ //
  BYTE >11,>11,>F1,>F1,>F1,>F1,>F1,>1F  * 00000738 ........ //
  BYTE >11,>11,>A1,>1B,>FA,>CB,>FA,>CA  * 00000740 ........ //
  BYTE >13,>13,>13,>13,>13,>13,>B3,>B1  * 00000748 ........ //
  BYTE >A3,>31,>13,>13,>B3,>B3,>B3,>13  * 00000750 .1...... //
  BYTE >CB,>2B,>1B,>1B,>E1,>F1,>31,>13  * 00000758 .+....1. //
  BYTE >F1,>F1,>F1,>F1,>F1,>F1,>F1,>F1  * 00000760 ........ //
  BYTE >1B,>F1,>F1,>F1,>1F,>B1,>1B,>61  * 00000768 .......a //
  BYTE >EF,>1F,>EF,>AF,>1F,>1F,>1F,>1F  * 00000770 ........ //
  BYTE >1F,>6F,>1F,>1F,>1F,>1F,>1F,>1F  * 00000778 .o...... //
  BYTE >FA,>FA,>AF,>BA,>2A,>FA,>FA,>FA  * 00000780 ....*... //
  BYTE >13,>31,>1B,>1B,>A1,>1A,>B1,>F1  * 00000788 .1...... //
  BYTE >13,>31,>13,>13,>13,>13,>13,>13  * 00000790 .1...... //
  BYTE >13,>13,>13,>31,>E1,>31,>31,>31  * 00000798 ...1.111 //
  BYTE >F1,>F1,>F1,>F1,>F1,>F1,>F1,>F1  * 000007A0 ........ //
  BYTE >1F,>FB,>F1,>1B,>1B,>6B,>1B,>1A  * 000007A8 .....k.. //
  BYTE >1F,>1F,>1F,>1F,>E1,>1B,>1B,>1B  * 000007B0 ........ //
  BYTE >BF,>1F,>1F,>1F,>1F,>B1,>1E,>A1  * 000007B8 ........ //
  BYTE >FA,>1A,>1A,>1B,>1A,>B1,>B1,>11  * 000007C0 ........ //
  BYTE >31,>31,>31,>31,>31,>31,>11,>11  * 000007C8 111111.. //
  BYTE >13,>13,>13,>13,>13,>13,>31,>31  * 000007D0 ......11 //
  BYTE >13,>13,>13,>13,>31,>13,>31,>13  * 000007D8 ....1.1. //
  BYTE >F1,>F1,>F1,>F1,>F1,>F1,>F1,>F1  * 000007E0 ........ //
  BYTE >1B,>1B,>B1,>A1,>11,>31,>11,>F1  * 000007E8 .....1.. //
  BYTE >1A,>AB,>FA,>3B,>1B,>1B,>1B,>1B  * 000007F0 ...;.... //
  BYTE >F1,>1B,>1B,>1A,>1A,>1B,>1B,>1A  * 000007F8 ........ //
  BYTE >11,>11,>11,>11,>11,>11,>11,>11  * 00000800 ........ //
  BYTE >11,>11,>11,>11,>11,>11,>11,>11  * 00000808 ........ //
  BYTE >11,>31,>31,>31,>31,>31,>11,>11  * 00000810 .11111.. //
  BYTE >13,>13,>13,>13,>1B,>B1,>1A,>B1  * 00000818 ........ //
  BYTE >1F,>11,>11,>11,>11,>11,>11,>11  * 00000820 ........ //
  BYTE >1F,>11,>11,>11,>11,>11,>11,>11  * 00000828 ........ //
  BYTE >1F,>11,>11,>11,>11,>11,>11,>11  * 00000830 ........ //
  BYTE >1F,>11,>11,>11,>11,>11,>11,>11  * 00000838 ........ //
  BYTE >1F,>11,>11,>11,>11,>11,>11,>11  * 00000840 ........ //
  BYTE >1F,>11,>11,>11,>11,>11,>11,>11  * 00000848 ........ //
  BYTE >1F,>11,>11,>11,>11,>11,>11,>11  * 00000850 ........ //
  BYTE >1F,>11,>11,>11,>11,>11,>11,>11  * 00000858 ........ //
  BYTE >1F,>B1,>21,>31,>F1,>11,>11,>11  * 00000860 ..!1.... //
  BYTE >1F,>12,>1C,>1C,>31,>11,>11,>11  * 00000868 ....1... //
  BYTE >1F,>1C,>12,>21,>C1,>11,>11,>11  * 00000870 ...!.... //
  BYTE >1F,>31,>31,>31,>1C,>11,>11,>11  * 00000878 .111.... //
  BYTE >1F,>13,>13,>C3,>13,>11,>11,>11  * 00000880 ........ //
  BYTE >1F,>B2,>AC,>FC,>3C,>11,>11,>11  * 00000888 ....<... //
  BYTE >1F,>13,>12,>12,>C1,>11,>11,>11  * 00000890 ........ //
  BYTE >1F,>12,>12,>12,>1C,>11,>11,>11  * 00000898 ........ //
  BYTE >1F,>13,>C1,>C1,>1C,>11,>11,>11  * 000008A0 ........ //
  BYTE >1F,>12,>12,>1C,>12,>11,>11,>11  * 000008A8 ........ //
  BYTE >1F,>13,>31,>C1,>F3,>11,>11,>11  * 000008B0 ..1..... //
  BYTE >1F,>31,>31,>31,>31,>11,>11,>11  * 000008B8 .1111... //
  BYTE >1F,>3C,>1C,>31,>12,>31,>21,>11  * 000008C0 .<.1.1!. //
  BYTE >1F,>12,>31,>C1,>13,>C1,>C1,>13  * 000008C8 ..1..... //
  BYTE >1F,>2C,>C1,>21,>12,>1C,>31,>31  * 000008D0 .,.!..11 //
  BYTE >1F,>11,>1C,>2C,>C2,>2C,>C2,>2C  * 000008D8 ...,.,., //
  BYTE >F1,>11,>F1,>FC,>FC,>FC,>EC,>FC  * 000008E0 ........ //
  BYTE >1F,>1F,>1F,>1F,>EF,>1F,>1F,>1F  * 000008E8 ........ //
  BYTE >1B,>1B,>1B,>1A,>1A,>1B,>1B,>1B  * 000008F0 ........ //
  BYTE >1A,>1B,>1B,>6B,>1B,>1B,>1B,>1B  * 000008F8 ...k.... //
  BYTE >11,>11,>11,>11,>11,>11,>A1,>1B  * 00000900 ........ //
  BYTE >11,>11,>11,>11,>11,>11,>11,>F1  * 00000908 ........ //
  BYTE >11,>11,>11,>11,>11,>11,>11,>11  * 00000910 ........ //
  BYTE >B1,>A1,>A1,>A1,>B1,>B1,>F1,>F1  * 00000918 ........ //
  BYTE >11,>11,>61,>F1,>1A,>1A,>FA,>6B  * 00000920 ..a....k //
  BYTE >11,>11,>11,>11,>11,>11,>11,>11  * 00000928 ........ //
  BYTE >11,>11,>11,>11,>11,>11,>11,>11  * 00000930 ........ //
  BYTE >18,>81,>81,>81,>81,>81,>11,>81  * 00000938 ........ //
  BYTE >11,>81,>81,>81,>81,>81,>11,>81  * 00000940 ........ //
  BYTE >18,>81,>81,>81,>81,>81,>18,>81  * 00000948 ........ //
  BYTE >18,>81,>81,>81,>81,>81,>18,>81  * 00000950 ........ //
  BYTE >11,>81,>81,>81,>81,>81,>18,>81  * 00000958 ........ //
  BYTE >18,>81,>81,>81,>81,>81,>18,>81  * 00000960 ........ //
  BYTE >18,>81,>81,>81,>81,>81,>18,>81  * 00000968 ........ //
  BYTE >18,>81,>81,>81,>81,>81,>11,>81  * 00000970 ........ //
  BYTE >18,>81,>81,>81,>81,>81,>18,>81  * 00000978 ........ //
  BYTE >18,>81,>81,>81,>81,>81,>18,>81  * 00000980 ........ //
  BYTE >11,>11,>11,>11,>11,>11,>11,>11  * 00000988 ........ //
  BYTE >11,>11,>11,>11,>11,>11,>11,>11  * 00000990 ........ //
  BYTE >11,>11,>11,>11,>11,>11,>11,>11  * 00000998 ........ //
  BYTE >11,>11,>11,>11,>11,>11,>11,>11  * 000009A0 ........ //
  BYTE >11,>11,>11,>11,>11,>11,>11,>11  * 000009A8 ........ //
  BYTE >11,>11,>11,>11,>11,>11,>11,>11  * 000009B0 ........ //
  BYTE >18,>81,>81,>81,>81,>81,>18,>81  * 000009B8 ........ //
  BYTE >C1,>31,>31,>C1,>31,>11,>11,>11  * 000009C0 .11.1... //
  BYTE >31,>31,>31,>13,>C1,>C1,>13,>13  * 000009C8 111..... //
  BYTE >C1,>21,>C1,>13,>21,>31,>13,>12  * 000009D0 .!..!1.. //
  BYTE >C2,>12,>1C,>1C,>21,>31,>31,>13  * 000009D8 ....!11. //
  BYTE >FC,>1C,>1C,>12,>1C,>C2,>1C,>1C  * 000009E0 ........ //
  BYTE >FA,>1F,>F1,>1F,>1F,>1B,>B1,>1B  * 000009E8 ........ //
  BYTE >1B,>61,>1F,>1F,>1F,>FC,>B1,>31  * 000009F0 .a.....1 //
  BYTE >1B,>6B,>1B,>1B,>EF,>1F,>1F,>1F  * 000009F8 .k...... //
  BYTE >1B,>FA,>FA,>1A,>1A,>1A,>1A,>BA  * 00000A00 ........ //
  BYTE >A1,>F1,>A1,>A1,>A1,>1B,>FA,>BA  * 00000A08 ........ //
  BYTE >11,>11,>11,>11,>B1,>A1,>A1,>1B  * 00000A10 ........ //
  BYTE >F1,>B1,>F1,>11,>B1,>1B,>1B,>1A  * 00000A18 ........ //
  BYTE >1B,>1A,>1A,>1B,>1A,>1A,>FA,>FA  * 00000A20 ........ //
  BYTE >11,>11,>11,>A1,>B1,>B1,>1A,>1A  * 00000A28 ........ //
  BYTE >A1,>F1,>A1,>11,>11,>11,>11,>A1  * 00000A30 ........ //
  BYTE >81,>81,>81,>81,>18,>11,>11,>11  * 00000A38 ........ //
  BYTE >81,>81,>81,>81,>11,>11,>11,>11  * 00000A40 ........ //
  BYTE >81,>81,>81,>81,>18,>11,>11,>11  * 00000A48 ........ //
  BYTE >81,>81,>81,>81,>18,>11,>11,>11  * 00000A50 ........ //
  BYTE >81,>81,>81,>81,>11,>11,>11,>11  * 00000A58 ........ //
  BYTE >81,>81,>81,>81,>18,>11,>11,>11  * 00000A60 ........ //
  BYTE >81,>81,>81,>81,>18,>11,>11,>11  * 00000A68 ........ //
  BYTE >81,>81,>81,>81,>11,>11,>11,>11  * 00000A70 ........ //
  BYTE >81,>81,>81,>81,>18,>11,>11,>11  * 00000A78 ........ //
  BYTE >81,>81,>81,>81,>18,>11,>11,>11  * 00000A80 ........ //
  BYTE >11,>11,>11,>11,>11,>11,>11,>11  * 00000A88 ........ //
  BYTE >11,>11,>11,>11,>11,>11,>11,>11  * 00000A90 ........ //
  BYTE >11,>11,>11,>11,>11,>11,>11,>11  * 00000A98 ........ //
  BYTE >11,>11,>11,>11,>11,>11,>11,>11  * 00000AA0 ........ //
  BYTE >11,>11,>11,>11,>11,>11,>11,>11  * 00000AA8 ........ //
  BYTE >11,>11,>11,>11,>11,>11,>11,>11  * 00000AB0 ........ //
  BYTE >81,>81,>81,>81,>18,>11,>11,>11  * 00000AB8 ........ //
  BYTE >11,>11,>11,>A1,>A1,>B1,>21,>21  * 00000AC0 ......!! //
  BYTE >12,>11,>31,>31,>A1,>1F,>C1,>23  * 00000AC8 ..11...# //
  BYTE >12,>C1,>C1,>31,>12,>13,>C1,>C1  * 00000AD0 ...1.... //
  BYTE >31,>31,>1C,>1C,>C1,>31,>F1,>31  * 00000AD8 11...1.1 //
  BYTE >13,>31,>31,>12,>3C,>31,>F1,>31  * 00000AE0 .11.<1.1 //
  BYTE >1B,>1B,>1B,>1B,>1B,>1B,>B1,>C1  * 00000AE8 ........ //
  BYTE >12,>13,>EC,>13,>13,>FC,>1F,>F1  * 00000AF0 ........ //
  BYTE >1F,>1F,>1F,>1F,>EF,>1F,>1F,>1F  * 00000AF8 ........ //
  BYTE >1A,>FA,>AF,>6A,>16,>18,>18,>18  * 00000B00 ...j.... //
  BYTE >1A,>1A,>FA,>FA,>1A,>B8,>F8,>18  * 00000B08 ........ //
  BYTE >FA,>FA,>FA,>1A,>1A,>1A,>1A,>FA  * 00000B10 ........ //
  BYTE >1A,>1A,>FA,>FA,>BA,>1A,>1A,>1A  * 00000B18 ........ //
  BYTE >1A,>1A,>1A,>1A,>1A,>1A,>1A,>1A  * 00000B20 ........ //
  BYTE >1A,>FA,>1A,>1A,>1A,>1A,>1A,>1A  * 00000B28 ........ //
  BYTE >1A,>B1,>1A,>A1,>A1,>A1,>A1,>1A  * 00000B30 ........ //
  BYTE >A1,>A1,>A1,>A1,>1A,>11,>11,>1A  * 00000B38 ........ //
  BYTE >A1,>A1,>A1,>A1,>A1,>11,>11,>1A  * 00000B40 ........ //
  BYTE >1A,>A1,>1A,>A1,>1A,>11,>11,>1A  * 00000B48 ........ //
  BYTE >A1,>A1,>A1,>A1,>A1,>11,>11,>1A  * 00000B50 ........ //
  BYTE >1A,>A1,>A1,>A1,>1A,>11,>11,>1A  * 00000B58 ........ //
  BYTE >1A,>A1,>1A,>A1,>A1,>11,>11,>1A  * 00000B60 ........ //
  BYTE >A1,>11,>A1,>11,>A1,>11,>11,>1A  * 00000B68 ........ //
  BYTE >11,>11,>11,>11,>11,>11,>11,>1A  * 00000B70 ........ //
  BYTE >11,>11,>11,>11,>11,>11,>11,>B8  * 00000B78 ........ //
  BYTE >11,>11,>11,>11,>11,>11,>11,>BA  * 00000B80 ........ //
  BYTE >11,>11,>11,>11,>11,>11,>11,>FA  * 00000B88 ........ //
  BYTE >11,>11,>11,>11,>11,>11,>11,>13  * 00000B90 ........ //
  BYTE >11,>11,>11,>11,>11,>11,>11,>13  * 00000B98 ........ //
  BYTE >11,>11,>11,>11,>11,>11,>11,>1C  * 00000BA0 ........ //
  BYTE >11,>11,>11,>11,>11,>11,>11,>C1  * 00000BA8 ........ //
  BYTE >A1,>A1,>A1,>A1,>1A,>11,>11,>12  * 00000BB0 ........ //
  BYTE >A1,>A1,>1A,>A1,>A1,>11,>11,>2C  * 00000BB8 ......., //
  BYTE >A1,>A1,>A1,>A1,>A1,>C1,>C1,>2C  * 00000BC0 ......., //
  BYTE >F3,>23,>23,>A2,>13,>FC,>C1,>21  * 00000BC8 .##....! //
  BYTE >1B,>31,>13,>3B,>F3,>C1,>FA,>1A  * 00000BD0 .1.;.... //
  BYTE >31,>13,>A1,>C1,>31,>C1,>A1,>1F  * 00000BD8 1...1... //
  BYTE >31,>13,>11,>C1,>13,>C1,>11,>31  * 00000BE0 1......1 //
  BYTE >31,>C1,>C1,>13,>13,>11,>31,>13  * 00000BE8 1.....1. //
  BYTE >F1,>CF,>FC,>F1,>F1,>F1,>F1,>1E  * 00000BF0 ........ //
  BYTE >BF,>1F,>1F,>1F,>1F,>1F,>1F,>1F  * 00000BF8 ........ //


* Size of data in above array
SIZE_OF_BORDCOL EQU 3072

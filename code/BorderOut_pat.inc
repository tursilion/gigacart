*
* Data file BorderOut_pat.bin - Dec 09, 2018
*

BORDSIT
  BYTE >60,>61,>62,>63,>64,>65,>66,>67  * 00000000 `abcdefg //
  BYTE >68,>69,>6A,>6B,>6C,>6D,>6E,>6F  * 00000008 hijklmno //
  BYTE >70,>71,>72,>73,>74,>75,>76,>77  * 00000010 pqrstuvw //
  BYTE >78,>79,>7A,>7B,>7C,>7D,>7E,>7F  * 00000018 xyz{|}~. //
  BYTE >80,>81,>82,>83,>84,>85,>86,>87  * 00000020 ........ //
  BYTE >88,>89,>8A,>8B,>8C,>8D,>8E,>8F  * 00000028 ........ //
  BYTE >90,>91,>92,>93,>94,>95,>96,>97  * 00000030 ........ //
  BYTE >98,>99,>9A,>9B,>9C,>9D,>9E,>9F  * 00000038 ........ //
  BYTE >A0,>A1,>A2,>A3,>A4,>A5,>A6,>A7  * 00000040 ........ //
  BYTE >A8,>A9,>AA,>AB,>AC,>AD,>AE,>AF  * 00000048 ........ //
  BYTE >B0,>B1,>B2,>B3,>B4,>B5,>B6,>B7  * 00000050 ........ //
  BYTE >B8,>B9,>BA,>BB,>BC,>BD,>BE,>BF  * 00000058 ........ //
  BYTE >C0,>C1,>C2,>C3,>C4,>C5,>C6,>C7  * 00000060 ........ //
  BYTE >C8,>C9,>CA,>CB,>CC,>CD,>CE,>CF  * 00000068 ........ //
  BYTE >D0,>D1,>D2,>D3,>D4,>D5,>D6,>D7  * 00000070 ........ //
  BYTE >D8,>D9,>DA,>DB,>DC,>DD,>DE,>DF  * 00000078 ........ //
  BYTE >E0,>E1,>E2,>E3,>00,>01,>02,>03  * 00000080 ........ //
  BYTE >04,>05,>06,>07,>08,>09,>0A,>0B  * 00000088 ........ //
  BYTE >0C,>0D,>0E,>0F,>10,>11,>12,>13  * 00000090 ........ //
  BYTE >14,>15,>16,>17,>E4,>E5,>E6,>E7  * 00000098 ........ //
  BYTE >E8,>E9,>EA,>EB,>18,>19,>1A,>1B  * 000000A0 ........ //
  BYTE >1C,>1D,>1E,>1F,>20,>21,>22,>23  * 000000A8 .... !"# //
  BYTE >24,>25,>26,>27,>28,>29,>2A,>2B  * 000000B0 $%&'()*+ //
  BYTE >2C,>2D,>2E,>2F,>EC,>ED,>EE,>EF  * 000000B8 ,-./.... //
  BYTE >F0,>F1,>F2,>F3,>30,>31,>32,>33  * 000000C0 ....0123 //
  BYTE >34,>35,>36,>37,>38,>39,>3A,>3B  * 000000C8 456789:; //
  BYTE >3C,>3D,>3E,>3F,>40,>41,>42,>43  * 000000D0 <=>?@ABC //
  BYTE >44,>45,>46,>47,>F4,>F5,>F6,>F7  * 000000D8 DEFG.... //
  BYTE >F8,>F9,>FA,>FB,>48,>49,>4A,>4B  * 000000E0 ....HIJK //
  BYTE >4C,>4D,>4E,>4F,>50,>51,>52,>53  * 000000E8 LMNOPQRS //
  BYTE >54,>55,>56,>57,>58,>59,>5A,>5B  * 000000F0 TUVWXYZ[ //
  BYTE >5C,>5D,>5E,>5F,>FC,>FD,>FE,>FF  * 000000F8 \]^_.... //
  BYTE >C0,>C1,>C2,>C3,>00,>01,>02,>03  * 00000100 ........ //
  BYTE >04,>05,>06,>07,>08,>09,>0A,>0B  * 00000108 ........ //
  BYTE >0C,>0D,>0E,>0F,>10,>11,>12,>13  * 00000110 ........ //
  BYTE >14,>15,>16,>17,>C4,>C5,>C6,>C7  * 00000118 ........ //
  BYTE >C8,>C9,>CA,>CB,>18,>19,>1A,>1B  * 00000120 ........ //
  BYTE >1C,>1D,>1E,>1F,>20,>21,>22,>23  * 00000128 .... !"# //
  BYTE >24,>25,>26,>27,>28,>29,>2A,>2B  * 00000130 $%&'()*+ //
  BYTE >2C,>2D,>2E,>2F,>CC,>CD,>CE,>CF  * 00000138 ,-./.... //
  BYTE >D0,>D1,>D2,>D3,>30,>31,>32,>33  * 00000140 ....0123 //
  BYTE >34,>35,>36,>37,>38,>39,>3A,>3B  * 00000148 456789:; //
  BYTE >3C,>3D,>3E,>3F,>40,>41,>42,>43  * 00000150 <=>?@ABC //
  BYTE >44,>45,>46,>47,>D4,>D5,>D6,>D7  * 00000158 DEFG.... //
  BYTE >D8,>D9,>DA,>DB,>48,>49,>4A,>4B  * 00000160 ....HIJK //
  BYTE >4C,>4D,>4E,>4F,>50,>51,>52,>53  * 00000168 LMNOPQRS //
  BYTE >54,>55,>56,>57,>58,>59,>5A,>5B  * 00000170 TUVWXYZ[ //
  BYTE >5C,>5D,>5E,>5F,>DC,>DD,>DE,>DF  * 00000178 \]^_.... //
  BYTE >E0,>E1,>E2,>E3,>60,>61,>62,>63  * 00000180 ....`abc //
  BYTE >64,>65,>66,>67,>68,>69,>6A,>6B  * 00000188 defghijk //
  BYTE >6C,>6D,>6E,>6F,>70,>71,>72,>73  * 00000190 lmnopqrs //
  BYTE >74,>75,>76,>77,>E4,>E5,>E6,>E7  * 00000198 tuvw.... //
  BYTE >E8,>E9,>EA,>EB,>78,>79,>7A,>7B  * 000001A0 ....xyz{ //
  BYTE >7C,>7D,>7E,>7F,>80,>81,>82,>83  * 000001A8 |}~..... //
  BYTE >84,>85,>86,>87,>88,>89,>8A,>8B  * 000001B0 ........ //
  BYTE >8C,>8D,>8E,>8F,>EC,>ED,>EE,>EF  * 000001B8 ........ //
  BYTE >F0,>F1,>F2,>F3,>90,>91,>92,>93  * 000001C0 ........ //
  BYTE >94,>95,>96,>97,>98,>99,>9A,>9B  * 000001C8 ........ //
  BYTE >9C,>9D,>9E,>9F,>A0,>A1,>A2,>A3  * 000001D0 ........ //
  BYTE >A4,>A5,>A6,>A7,>F4,>F5,>F6,>F7  * 000001D8 ........ //
  BYTE >F8,>F9,>FA,>FB,>A8,>A9,>AA,>AB  * 000001E0 ........ //
  BYTE >AC,>AD,>AE,>AF,>B0,>B1,>B2,>B3  * 000001E8 ........ //
  BYTE >B4,>B5,>B6,>B7,>B8,>B9,>BA,>BB  * 000001F0 ........ //
  BYTE >BC,>BD,>BE,>BF,>FC,>FD,>FE,>FF  * 000001F8 ........ //
  BYTE >60,>61,>62,>63,>00,>01,>02,>03  * 00000200 `abc.... //
  BYTE >04,>05,>06,>07,>08,>09,>0A,>0B  * 00000208 ........ //
  BYTE >0C,>0D,>0E,>0F,>10,>11,>12,>13  * 00000210 ........ //
  BYTE >14,>15,>16,>17,>64,>65,>66,>67  * 00000218 ....defg //
  BYTE >68,>69,>6A,>6B,>18,>19,>1A,>1B  * 00000220 hijk.... //
  BYTE >1C,>1D,>1E,>1F,>20,>21,>22,>23  * 00000228 .... !"# //
  BYTE >24,>25,>26,>27,>28,>29,>2A,>2B  * 00000230 $%&'()*+ //
  BYTE >2C,>2D,>2E,>2F,>6C,>6D,>6E,>6F  * 00000238 ,-./lmno //
  BYTE >70,>71,>72,>73,>30,>31,>32,>33  * 00000240 pqrs0123 //
  BYTE >34,>35,>36,>37,>38,>39,>3A,>3B  * 00000248 456789:; //
  BYTE >3C,>3D,>3E,>3F,>40,>41,>42,>43  * 00000250 <=>?@ABC //
  BYTE >44,>45,>46,>47,>74,>75,>76,>77  * 00000258 DEFGtuvw //
  BYTE >78,>79,>7A,>7B,>48,>49,>4A,>4B  * 00000260 xyz{HIJK //
  BYTE >4C,>4D,>4E,>4F,>50,>51,>52,>53  * 00000268 LMNOPQRS //
  BYTE >54,>55,>56,>57,>58,>59,>5A,>5B  * 00000270 TUVWXYZ[ //
  BYTE >5C,>5D,>5E,>5F,>7C,>7D,>7E,>7F  * 00000278 \]^_|}~. //
  BYTE >80,>81,>82,>83,>84,>85,>86,>87  * 00000280 ........ //
  BYTE >88,>89,>8A,>8B,>8C,>8D,>8E,>8F  * 00000288 ........ //
  BYTE >90,>91,>92,>93,>94,>95,>96,>97  * 00000290 ........ //
  BYTE >98,>99,>9A,>9B,>9C,>9D,>9E,>9F  * 00000298 ........ //
  BYTE >A0,>A1,>A2,>A3,>A4,>A5,>A6,>A7  * 000002A0 ........ //
  BYTE >A7,>A7,>A7,>A7,>A7,>B1,>B1,>B1  * 000002A8 ........ //
  BYTE >B1,>B1,>B2,>B3,>B4,>B5,>B6,>A7  * 000002B0 ........ //
  BYTE >B8,>B9,>BA,>BB,>BC,>BD,>BE,>BF  * 000002B8 ........ //
  BYTE >C0,>C1,>C2,>C3,>C4,>C5,>C6,>C7  * 000002C0 ........ //
  BYTE >C7,>C7,>C7,>C7,>C7,>B1,>B1,>B1  * 000002C8 ........ //
  BYTE >B1,>D1,>D2,>D3,>D4,>D5,>D6,>C7  * 000002D0 ........ //
  BYTE >D8,>D9,>DA,>DB,>DC,>DD,>DE,>DF  * 000002D8 ........ //
  BYTE >E0,>E1,>E2,>E3,>E4,>E5,>E6,>E7  * 000002E0 ........ //
  BYTE >E8,>E9,>EA,>EB,>EC,>ED,>EE,>EF  * 000002E8 ........ //
  BYTE >F0,>F1,>F2,>F3,>F4,>F5,>F6,>F7  * 000002F0 ........ //
  BYTE >F8,>F9,>FA,>FB,>FC,>FD,>FE,>FF  * 000002F8 ........ //


* Size of data in above array
SIZE_OF_BORDSIT EQU 768

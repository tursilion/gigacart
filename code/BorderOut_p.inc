*
* Data file BorderOut_p.bin - Dec 09, 2018
*

BORDPAT
  BYTE >00,>00,>00,>00,>00,>00,>00,>00  * 00000000 ........ //
  BYTE >00,>00,>00,>00,>00,>01,>07,>00  * 00000008 ........ //
  BYTE >00,>00,>00,>30,>00,>00,>00,>00  * 00000010 ...0.... //
  BYTE >00,>00,>00,>00,>00,>00,>00,>01  * 00000018 ........ //
  BYTE >00,>00,>00,>00,>07,>01,>00,>30  * 00000020 .......0 //
  BYTE >00,>00,>00,>00,>00,>00,>80,>C0  * 00000028 ........ //
  BYTE >00,>00,>00,>00,>00,>00,>00,>87  * 00000030 ........ //
  BYTE >00,>00,>00,>00,>00,>00,>00,>00  * 00000038 ........ //
  BYTE >00,>00,>00,>00,>00,>00,>00,>01  * 00000040 ........ //
  BYTE >00,>00,>00,>00,>00,>00,>00,>01  * 00000048 ........ //
  BYTE >00,>00,>00,>00,>00,>00,>00,>00  * 00000050 ........ //
  BYTE >00,>00,>00,>00,>00,>00,>00,>03  * 00000058 ........ //
  BYTE >00,>00,>00,>00,>00,>00,>00,>E0  * 00000060 ........ //
  BYTE >00,>00,>00,>00,>00,>00,>00,>00  * 00000068 ........ //
  BYTE >00,>00,>00,>00,>00,>00,>00,>20  * 00000070 .......  //
  BYTE >00,>00,>00,>00,>00,>00,>00,>00  * 00000078 ........ //
  BYTE >00,>00,>00,>00,>00,>00,>00,>01  * 00000080 ........ //
  BYTE >00,>00,>01,>01,>01,>00,>00,>E0  * 00000088 ........ //
  BYTE >00,>00,>C0,>80,>00,>00,>00,>01  * 00000090 ........ //
  BYTE >00,>00,>00,>00,>00,>00,>00,>07  * 00000098 ........ //
  BYTE >00,>00,>00,>00,>00,>00,>00,>00  * 000000A0 ........ //
  BYTE >00,>00,>00,>00,>00,>00,>00,>F0  * 000000A8 ........ //
  BYTE >00,>00,>00,>00,>00,>00,>00,>C0  * 000000B0 ........ //
  BYTE >00,>00,>00,>00,>00,>00,>00,>00  * 000000B8 ........ //
  BYTE >00,>00,>00,>00,>00,>00,>00,>E0  * 000000C0 ........ //
  BYTE >00,>00,>00,>00,>00,>00,>00,>E0  * 000000C8 ........ //
  BYTE >00,>00,>00,>00,>00,>00,>00,>E0  * 000000D0 ........ //
  BYTE >00,>00,>00,>00,>00,>00,>00,>07  * 000000D8 ........ //
  BYTE >00,>00,>00,>00,>00,>00,>00,>C0  * 000000E0 ........ //
  BYTE >00,>00,>00,>00,>00,>00,>00,>00  * 000000E8 ........ //
  BYTE >00,>00,>00,>00,>00,>00,>00,>00  * 000000F0 ........ //
  BYTE >00,>00,>00,>00,>00,>00,>00,>00  * 000000F8 ........ //
  BYTE >00,>00,>00,>00,>00,>00,>00,>00  * 00000100 ........ //
  BYTE >00,>00,>00,>00,>00,>00,>00,>00  * 00000108 ........ //
  BYTE >00,>00,>00,>00,>00,>00,>00,>00  * 00000110 ........ //
  BYTE >03,>F0,>E0,>F0,>F0,>F0,>F0,>F0  * 00000118 ........ //
  BYTE >C3,>C1,>C0,>C0,>C0,>C0,>C0,>C0  * 00000120 ........ //
  BYTE >E0,>F0,>87,>C1,>E0,>F0,>F0,>E0  * 00000128 ........ //
  BYTE >80,>87,>87,>87,>87,>07,>06,>00  * 00000130 ........ //
  BYTE >03,>C0,>E0,>F0,>E0,>83,>F0,>E0  * 00000138 ........ //
  BYTE >00,>00,>80,>80,>03,>07,>0E,>E1  * 00000140 ........ //
  BYTE >80,>C0,>C0,>10,>87,>07,>03,>03  * 00000148 ........ //
  BYTE >00,>00,>81,>83,>C3,>38,>18,>18  * 00000150 .....8.. //
  BYTE >E0,>83,>F0,>E0,>E0,>C0,>C0,>E0  * 00000158 ........ //
  BYTE >01,>C1,>04,>00,>00,>00,>01,>C0  * 00000160 ........ //
  BYTE >00,>01,>07,>0E,>38,>70,>F0,>07  * 00000168 ....8p.. //
  BYTE >F0,>03,>01,>00,>E0,>F0,>03,>01  * 00000170 ........ //
  BYTE >00,>0C,>F0,>70,>10,>00,>00,>00  * 00000178 ...p.... //
  BYTE >01,>00,>00,>80,>E0,>F0,>03,>00  * 00000180 ........ //
  BYTE >E0,>E0,>C0,>C0,>C0,>C0,>C0,>C0  * 00000188 ........ //
  BYTE >F0,>C0,>80,>C0,>E0,>F0,>03,>01  * 00000190 ........ //
  BYTE >87,>03,>03,>00,>C0,>E0,>F0,>07  * 00000198 ........ //
  BYTE >00,>80,>00,>00,>00,>00,>00,>00  * 000001A0 ........ //
  BYTE >07,>07,>07,>07,>07,>07,>07,>07  * 000001A8 ........ //
  BYTE >C0,>C0,>C0,>C0,>C0,>C0,>C0,>C0  * 000001B0 ........ //
  BYTE >00,>00,>00,>00,>00,>01,>03,>03  * 000001B8 ........ //
  BYTE >F0,>07,>F0,>30,>70,>E0,>C0,>C0  * 000001C0 ...0p... //
  BYTE >E0,>F0,>F0,>07,>07,>83,>83,>81  * 000001C8 ........ //
  BYTE >E0,>F0,>F0,>F0,>F0,>F0,>F0,>F0  * 000001D0 ........ //
  BYTE >03,>03,>03,>03,>03,>03,>03,>03  * 000001D8 ........ //
  BYTE >00,>C0,>C0,>C0,>C0,>C0,>C3,>30  * 000001E0 .......0 //
  BYTE >C0,>F0,>87,>C3,>83,>F0,>C0,>80  * 000001E8 ........ //
  BYTE >00,>00,>00,>00,>00,>00,>00,>00  * 000001F0 ........ //
  BYTE >00,>00,>00,>00,>00,>00,>00,>00  * 000001F8 ........ //
  BYTE >00,>00,>00,>00,>00,>00,>00,>00  * 00000200 ........ //
  BYTE >00,>00,>00,>00,>00,>00,>00,>00  * 00000208 ........ //
  BYTE >00,>00,>00,>00,>00,>00,>00,>00  * 00000210 ........ //
  BYTE >F0,>F0,>F0,>F0,>F0,>F0,>F0,>01  * 00000218 ........ //
  BYTE >C0,>C0,>C3,>38,>20,>00,>01,>07  * 00000220 ...8 ... //
  BYTE >81,>07,>F0,>E0,>80,>00,>00,>00  * 00000228 ........ //
  BYTE >80,>86,>87,>87,>87,>87,>07,>00  * 00000230 ........ //
  BYTE >F0,>07,>03,>81,>C0,>E0,>07,>03  * 00000238 ........ //
  BYTE >C3,>C3,>81,>80,>00,>01,>F0,>F0  * 00000240 ........ //
  BYTE >03,>F0,>38,>E0,>80,>00,>00,>00  * 00000248 ..8..... //
  BYTE >00,>0C,>06,>07,>83,>83,>81,>00  * 00000250 ........ //
  BYTE >E0,>F0,>07,>03,>80,>E0,>03,>00  * 00000258 ........ //
  BYTE >C1,>E1,>E1,>E1,>01,>01,>01,>00  * 00000260 ........ //
  BYTE >03,>80,>C0,>F0,>07,>01,>00,>00  * 00000268 ........ //
  BYTE >00,>01,>C3,>00,>01,>07,>60,>00  * 00000270 ......`. //
  BYTE >01,>01,>31,>0E,>0E,>0E,>F0,>00  * 00000278 ..1..... //
  BYTE >00,>C0,>F0,>07,>03,>00,>00,>00  * 00000280 ........ //
  BYTE >C0,>C0,>C0,>C1,>C0,>C0,>00,>00  * 00000288 ........ //
  BYTE >00,>00,>60,>F0,>07,>80,>F0,>00  * 00000290 ..`..... //
  BYTE >03,>81,>C0,>E0,>C0,>03,>F0,>00  * 00000298 ........ //
  BYTE >00,>00,>80,>80,>00,>00,>00,>00  * 000002A0 ........ //
  BYTE >07,>07,>07,>07,>07,>F0,>F0,>00  * 000002A8 ........ //
  BYTE >C0,>C0,>C0,>C0,>C3,>00,>00,>00  * 000002B0 ........ //
  BYTE >07,>D8,>98,>10,>30,>30,>38,>00  * 000002B8 ....008. //
  BYTE >80,>83,>30,>03,>F0,>C0,>00,>00  * 000002C0 ..0..... //
  BYTE >00,>00,>E0,>E0,>F0,>F0,>E0,>00  * 000002C8 ........ //
  BYTE >F0,>F0,>F0,>70,>70,>30,>00,>00  * 000002D0 ...pp0.. //
  BYTE >03,>03,>03,>03,>03,>07,>87,>00  * 000002D8 ........ //
  BYTE >00,>20,>38,>C3,>C0,>C0,>E0,>00  * 000002E0 . 8..... //
  BYTE >00,>80,>C0,>E0,>F0,>83,>C1,>E0  * 000002E8 ........ //
  BYTE >00,>00,>00,>00,>00,>00,>00,>00  * 000002F0 ........ //
  BYTE >00,>00,>00,>00,>00,>00,>00,>00  * 000002F8 ........ //
  BYTE >00,>00,>00,>00,>00,>00,>00,>00  * 00000300 ........ //
  BYTE >00,>00,>00,>00,>00,>00,>00,>00  * 00000308 ........ //
  BYTE >00,>00,>00,>03,>01,>00,>00,>00  * 00000310 ........ //
  BYTE >07,>F0,>C0,>03,>C0,>00,>00,>01  * 00000318 ........ //
  BYTE >F0,>E0,>80,>00,>00,>00,>00,>00  * 00000320 ........ //
  BYTE >00,>00,>00,>00,>00,>00,>00,>00  * 00000328 ........ //
  BYTE >00,>00,>00,>00,>00,>00,>00,>00  * 00000330 ........ //
  BYTE >01,>00,>00,>00,>00,>00,>00,>00  * 00000338 ........ //
  BYTE >07,>01,>E0,>00,>00,>00,>00,>00  * 00000340 ........ //
  BYTE >00,>00,>00,>00,>00,>00,>00,>00  * 00000348 ........ //
  BYTE >00,>00,>00,>00,>00,>00,>00,>00  * 00000350 ........ //
  BYTE >00,>00,>00,>00,>00,>00,>00,>00  * 00000358 ........ //
  BYTE >00,>00,>00,>00,>00,>00,>00,>00  * 00000360 ........ //
  BYTE >00,>00,>00,>00,>00,>00,>00,>00  * 00000368 ........ //
  BYTE >00,>00,>00,>00,>00,>00,>00,>00  * 00000370 ........ //
  BYTE >00,>00,>00,>00,>00,>00,>00,>00  * 00000378 ........ //
  BYTE >00,>00,>00,>00,>00,>00,>00,>00  * 00000380 ........ //
  BYTE >00,>00,>00,>00,>00,>00,>00,>00  * 00000388 ........ //
  BYTE >00,>00,>00,>00,>00,>00,>00,>00  * 00000390 ........ //
  BYTE >00,>00,>00,>00,>00,>00,>00,>00  * 00000398 ........ //
  BYTE >00,>00,>00,>00,>00,>00,>00,>00  * 000003A0 ........ //
  BYTE >00,>00,>00,>00,>00,>00,>00,>00  * 000003A8 ........ //
  BYTE >00,>00,>00,>00,>00,>00,>00,>00  * 000003B0 ........ //
  BYTE >00,>00,>00,>00,>00,>00,>00,>00  * 000003B8 ........ //
  BYTE >00,>00,>00,>00,>00,>00,>00,>00  * 000003C0 ........ //
  BYTE >00,>00,>00,>00,>00,>00,>00,>00  * 000003C8 ........ //
  BYTE >00,>00,>00,>00,>00,>00,>00,>00  * 000003D0 ........ //
  BYTE >00,>00,>00,>00,>00,>00,>00,>00  * 000003D8 ........ //
  BYTE >00,>00,>00,>00,>00,>00,>00,>80  * 000003E0 ........ //
  BYTE >07,>03,>01,>00,>00,>00,>00,>00  * 000003E8 ........ //
  BYTE >80,>E0,>07,>C1,>00,>00,>00,>00  * 000003F0 ........ //
  BYTE >00,>00,>00,>00,>00,>00,>00,>00  * 000003F8 ........ //
  BYTE >00,>00,>00,>00,>00,>00,>00,>00  * 00000400 ........ //
  BYTE >00,>00,>00,>00,>00,>00,>00,>00  * 00000408 ........ //
  BYTE >00,>00,>00,>00,>00,>00,>00,>00  * 00000410 ........ //
  BYTE >01,>01,>01,>01,>01,>01,>01,>01  * 00000418 ........ //
  BYTE >80,>80,>80,>80,>80,>80,>80,>80  * 00000420 ........ //
  BYTE >00,>00,>00,>00,>00,>00,>00,>00  * 00000428 ........ //
  BYTE >00,>00,>00,>00,>00,>00,>00,>00  * 00000430 ........ //
  BYTE >00,>00,>00,>00,>00,>00,>00,>00  * 00000438 ........ //
  BYTE >00,>00,>00,>00,>00,>00,>00,>00  * 00000440 ........ //
  BYTE >00,>00,>00,>00,>00,>00,>00,>00  * 00000448 ........ //
  BYTE >00,>00,>00,>00,>00,>00,>00,>00  * 00000450 ........ //
  BYTE >01,>01,>01,>01,>01,>01,>01,>01  * 00000458 ........ //
  BYTE >80,>80,>80,>80,>80,>80,>80,>80  * 00000460 ........ //
  BYTE >00,>00,>00,>00,>00,>00,>00,>00  * 00000468 ........ //
  BYTE >00,>00,>00,>00,>00,>00,>00,>00  * 00000470 ........ //
  BYTE >00,>00,>00,>00,>00,>00,>00,>00  * 00000478 ........ //
  BYTE >00,>00,>00,>00,>00,>00,>00,>00  * 00000480 ........ //
  BYTE >00,>00,>00,>00,>00,>00,>00,>00  * 00000488 ........ //
  BYTE >00,>00,>00,>00,>00,>00,>00,>00  * 00000490 ........ //
  BYTE >01,>01,>01,>01,>01,>01,>01,>01  * 00000498 ........ //
  BYTE >80,>80,>80,>80,>80,>80,>80,>80  * 000004A0 ........ //
  BYTE >00,>00,>00,>00,>00,>00,>00,>00  * 000004A8 ........ //
  BYTE >00,>00,>00,>00,>00,>00,>00,>00  * 000004B0 ........ //
  BYTE >00,>00,>00,>00,>00,>00,>00,>00  * 000004B8 ........ //
  BYTE >00,>00,>00,>00,>00,>00,>00,>00  * 000004C0 ........ //
  BYTE >00,>00,>00,>00,>00,>00,>00,>00  * 000004C8 ........ //
  BYTE >00,>00,>00,>00,>00,>00,>00,>00  * 000004D0 ........ //
  BYTE >01,>01,>01,>01,>01,>01,>01,>01  * 000004D8 ........ //
  BYTE >80,>80,>80,>80,>80,>80,>80,>80  * 000004E0 ........ //
  BYTE >00,>00,>00,>00,>00,>00,>00,>00  * 000004E8 ........ //
  BYTE >00,>00,>00,>00,>00,>00,>00,>00  * 000004F0 ........ //
  BYTE >00,>00,>00,>00,>00,>00,>00,>00  * 000004F8 ........ //
  BYTE >00,>00,>00,>00,>00,>00,>00,>00  * 00000500 ........ //
  BYTE >00,>00,>00,>00,>00,>00,>00,>00  * 00000508 ........ //
  BYTE >00,>00,>00,>00,>00,>00,>00,>00  * 00000510 ........ //
  BYTE >01,>01,>01,>01,>01,>01,>01,>01  * 00000518 ........ //
  BYTE >80,>80,>80,>80,>80,>80,>80,>80  * 00000520 ........ //
  BYTE >00,>00,>00,>00,>00,>00,>00,>00  * 00000528 ........ //
  BYTE >00,>00,>00,>00,>00,>00,>00,>00  * 00000530 ........ //
  BYTE >00,>00,>00,>00,>00,>00,>00,>00  * 00000538 ........ //
  BYTE >00,>00,>00,>00,>00,>00,>00,>00  * 00000540 ........ //
  BYTE >00,>00,>00,>00,>00,>00,>00,>00  * 00000548 ........ //
  BYTE >00,>00,>00,>00,>00,>00,>00,>00  * 00000550 ........ //
  BYTE >01,>01,>01,>01,>01,>01,>01,>01  * 00000558 ........ //
  BYTE >80,>80,>80,>80,>80,>80,>80,>80  * 00000560 ........ //
  BYTE >00,>00,>00,>00,>00,>00,>00,>00  * 00000568 ........ //
  BYTE >00,>00,>00,>00,>00,>00,>00,>00  * 00000570 ........ //
  BYTE >00,>00,>00,>00,>00,>00,>00,>00  * 00000578 ........ //
  BYTE >00,>00,>00,>00,>00,>00,>00,>00  * 00000580 ........ //
  BYTE >00,>00,>00,>00,>00,>00,>00,>00  * 00000588 ........ //
  BYTE >00,>00,>00,>00,>00,>00,>00,>00  * 00000590 ........ //
  BYTE >01,>01,>01,>01,>01,>01,>01,>01  * 00000598 ........ //
  BYTE >80,>80,>80,>80,>80,>80,>C0,>C0  * 000005A0 ........ //
  BYTE >00,>00,>00,>00,>00,>00,>23,>F0  * 000005A8 ......#. //
  BYTE >00,>00,>00,>00,>60,>60,>60,>00  * 000005B0 ....```. //
  BYTE >00,>00,>00,>00,>00,>00,>00,>00  * 000005B8 ........ //
  BYTE >00,>00,>00,>00,>00,>00,>00,>00  * 000005C0 ........ //
  BYTE >00,>00,>00,>00,>00,>00,>00,>00  * 000005C8 ........ //
  BYTE >00,>00,>00,>00,>00,>00,>00,>00  * 000005D0 ........ //
  BYTE >01,>01,>01,>01,>01,>01,>01,>01  * 000005D8 ........ //
  BYTE >C3,>50,>48,>24,>14,>CC,>C5,>86  * 000005E0 .PH$.... //
  BYTE >0B,>07,>07,>07,>E0,>0C,>8C,>11  * 000005E8 ........ //
  BYTE >00,>00,>00,>00,>00,>00,>00,>00  * 000005F0 ........ //
  BYTE >00,>00,>00,>00,>00,>00,>00,>00  * 000005F8 ........ //
  BYTE >00,>00,>00,>00,>00,>00,>00,>00  * 00000600 ........ //
  BYTE >00,>00,>00,>01,>02,>08,>20,>40  * 00000608 ...... @ //
  BYTE >00,>02,>30,>80,>03,>00,>00,>00  * 00000610 ..0..... //
  BYTE >09,>87,>41,>81,>01,>01,>01,>01  * 00000618 ..A..... //
  BYTE >86,>83,>80,>80,>80,>80,>80,>80  * 00000620 ........ //
  BYTE >06,>07,>07,>07,>07,>07,>03,>03  * 00000628 ........ //
  BYTE >00,>00,>80,>C0,>C0,>E0,>F0,>07  * 00000630 ........ //
  BYTE >00,>00,>00,>00,>00,>00,>00,>00  * 00000638 ........ //
  BYTE >00,>00,>01,>00,>02,>00,>04,>04  * 00000640 ........ //
  BYTE >80,>00,>00,>00,>00,>00,>00,>00  * 00000648 ........ //
  BYTE >00,>20,>00,>40,>40,>40,>00,>00  * 00000650 . .@@@.. //
  BYTE >01,>01,>01,>01,>01,>01,>01,>01  * 00000658 ........ //
  BYTE >80,>80,>80,>80,>80,>80,>80,>80  * 00000660 ........ //
  BYTE >03,>01,>00,>00,>00,>00,>00,>00  * 00000668 ........ //
  BYTE >07,>03,>03,>83,>C3,>C3,>83,>83  * 00000670 ........ //
  BYTE >00,>00,>00,>00,>00,>00,>00,>00  * 00000678 ........ //
  BYTE >0C,>0C,>08,>08,>10,>10,>10,>10  * 00000680 ........ //
  BYTE >00,>00,>00,>00,>00,>00,>00,>00  * 00000688 ........ //
  BYTE >C0,>C0,>80,>00,>80,>80,>80,>00  * 00000690 ........ //
  BYTE >01,>01,>01,>01,>01,>41,>0A,>52  * 00000698 .....A.R //
  BYTE >80,>80,>80,>80,>80,>80,>80,>80  * 000006A0 ........ //
  BYTE >00,>00,>00,>00,>00,>00,>00,>00  * 000006A8 ........ //
  BYTE >83,>83,>03,>03,>03,>01,>19,>18  * 000006B0 ........ //
  BYTE >00,>00,>00,>00,>00,>00,>00,>00  * 000006B8 ........ //
  BYTE >10,>10,>00,>08,>08,>04,>04,>06  * 000006C0 ........ //
  BYTE >00,>01,>01,>00,>01,>01,>01,>01  * 000006C8 ........ //
  BYTE >01,>81,>83,>C3,>B8,>87,>F0,>F0  * 000006D0 ........ //
  BYTE >41,>03,>15,>01,>51,>23,>15,>54  * 000006D8 A...Q#.T //
  BYTE >80,>80,>80,>80,>80,>81,>80,>83  * 000006E0 ........ //
  BYTE >00,>E1,>C8,>80,>90,>40,>E0,>A0  * 000006E8 .....@.. //
  BYTE >81,>80,>01,>40,>C0,>80,>07,>E0  * 000006F0 ...@.... //
  BYTE >00,>00,>80,>C0,>C0,>C0,>80,>80  * 000006F8 ........ //
  BYTE >07,>03,>02,>00,>00,>00,>00,>00  * 00000700 ........ //
  BYTE >01,>01,>01,>81,>40,>40,>20,>31  * 00000708 ....@@ 1 //
  BYTE >F0,>F0,>E0,>C0,>C0,>80,>80,>C0  * 00000710 ........ //
  BYTE >05,>24,>15,>10,>45,>09,>11,>23  * 00000718 .$..E..# //
  BYTE >83,>87,>87,>83,>83,>83,>83,>83  * 00000720 ........ //
  BYTE >8B,>E4,>43,>87,>87,>87,>B8,>42  * 00000728 ..C....B //
  BYTE >0E,>41,>31,>90,>E0,>80,>80,>00  * 00000730 .A1..... //
  BYTE >00,>00,>C0,>E0,>F0,>F0,>E8,>23  * 00000738 .......# //
  BYTE >00,>00,>80,>07,>54,>C0,>05,>07  * 00000740 ....T... //
  BYTE >E8,>F0,>E0,>E0,>E0,>20,>E0,>C0  * 00000748 ..... .. //
  BYTE >0E,>F0,>19,>10,>06,>06,>06,>13  * 00000750 ........ //
  BYTE >26,>58,>80,>86,>C1,>01,>61,>0E  * 00000758 &X....a. //
  BYTE >83,>80,>80,>80,>80,>80,>80,>80  * 00000760 ........ //
  BYTE >44,>23,>07,>03,>B8,>34,>87,>A1  * 00000768 D#...4.. //
  BYTE >88,>03,>02,>1C,>C0,>00,>00,>80  * 00000770 ........ //
  BYTE >21,>40,>40,>40,>C0,>00,>00,>00  * 00000778 !@@@.... //
  BYTE >50,>02,>AA,>E8,>10,>2A,>54,>A0  * 00000780 P....*T. //
  BYTE >60,>B8,>50,>38,>C0,>06,>F0,>C6  * 00000788 `.P8.... //
  BYTE >11,>62,>F0,>60,>8C,>18,>10,>00  * 00000790 .b.`.... //
  BYTE >06,>E2,>60,>87,>81,>C1,>E1,>E1  * 00000798 ..`..... //
  BYTE >80,>80,>81,>81,>81,>81,>81,>80  * 000007A0 ........ //
  BYTE >81,>07,>C1,>21,>60,>60,>60,>E0  * 000007A8 ...!```. //
  BYTE >C0,>E0,>B0,>C8,>83,>32,>19,>07  * 000007B0 .....2.. //
  BYTE >01,>01,>06,>0D,>13,>9A,>9C,>0D  * 000007B8 ........ //
  BYTE >45,>01,>81,>01,>83,>38,>18,>00  * 000007C0 E....8.. //
  BYTE >06,>06,>07,>03,>03,>01,>00,>00  * 000007C8 ........ //
  BYTE >C3,>C2,>E0,>E0,>F0,>F0,>07,>02  * 000007D0 ........ //
  BYTE >0E,>0E,>06,>0E,>C5,>60,>31,>8A  * 000007D8 .....`1. //
  BYTE >80,>80,>80,>80,>80,>80,>80,>80  * 000007E0 ........ //
  BYTE >E0,>F0,>07,>03,>00,>0E,>00,>07  * 000007E8 ........ //
  BYTE >01,>44,>41,>80,>E0,>E0,>E0,>40  * 000007F0 .DA....@ //
  BYTE >07,>A0,>60,>30,>10,>10,>30,>70  * 000007F8 ..`0..0p //
  BYTE >00,>00,>00,>00,>00,>00,>00,>00  * 00000800 ........ //
  BYTE >00,>00,>00,>00,>00,>00,>00,>00  * 00000808 ........ //
  BYTE >00,>07,>0C,>05,>01,>01,>00,>00  * 00000810 ........ //
  BYTE >02,>00,>0E,>14,>23,>8C,>91,>06  * 00000818 ....#... //
  BYTE >00,>00,>00,>00,>00,>00,>00,>00  * 00000820 ........ //
  BYTE >00,>00,>00,>00,>00,>00,>00,>00  * 00000828 ........ //
  BYTE >00,>00,>00,>00,>00,>00,>00,>00  * 00000830 ........ //
  BYTE >00,>00,>00,>00,>00,>00,>00,>00  * 00000838 ........ //
  BYTE >00,>00,>00,>00,>00,>00,>00,>00  * 00000840 ........ //
  BYTE >00,>00,>00,>00,>00,>00,>00,>00  * 00000848 ........ //
  BYTE >00,>00,>00,>00,>00,>00,>00,>00  * 00000850 ........ //
  BYTE >00,>00,>00,>00,>00,>00,>00,>00  * 00000858 ........ //
  BYTE >00,>07,>07,>04,>0D,>00,>00,>00  * 00000860 ........ //
  BYTE >00,>40,>80,>C0,>24,>00,>00,>00  * 00000868 .@..$... //
  BYTE >00,>02,>23,>CC,>CC,>00,>00,>00  * 00000870 ..#..... //
  BYTE >00,>8C,>8C,>26,>C8,>00,>00,>00  * 00000878 ...&.... //
  BYTE >00,>C8,>C0,>E1,>A0,>00,>00,>00  * 00000880 ........ //
  BYTE >00,>08,>F0,>38,>19,>00,>00,>00  * 00000888 ...8.... //
  BYTE >00,>0C,>08,>19,>F0,>00,>00,>00  * 00000890 ........ //
  BYTE >00,>18,>30,>F0,>E0,>00,>00,>00  * 00000898 ..0..... //
  BYTE >00,>61,>90,>82,>61,>00,>00,>00  * 000008A0 .a..a... //
  BYTE >00,>C2,>C3,>81,>80,>00,>00,>00  * 000008A8 ........ //
  BYTE >00,>0E,>83,>26,>41,>00,>00,>00  * 000008B0 ...&A... //
  BYTE >00,>18,>E0,>E0,>87,>00,>00,>00  * 000008B8 ........ //
  BYTE >00,>0B,>C2,>20,>08,>03,>01,>00  * 000008C0 ... .... //
  BYTE >00,>38,>61,>38,>61,>F0,>F0,>0C  * 000008C8 .8a8a... //
  BYTE >00,>30,>F0,>87,>C0,>E0,>07,>23  * 000008D0 .0.....# //
  BYTE >00,>00,>AA,>AA,>AA,>22,>AA,>2A  * 000008D8 .....".* //
  BYTE >80,>00,>01,>03,>13,>03,>03,>01  * 000008E0 ........ //
  BYTE >E0,>80,>00,>00,>80,>00,>10,>08  * 000008E8 ........ //
  BYTE >40,>C1,>81,>82,>82,>83,>86,>84  * 000008F0 @....... //
  BYTE >F0,>B8,>38,>4C,>84,>87,>8C,>58  * 000008F8 ..8L...X //
  BYTE >00,>00,>00,>00,>00,>00,>01,>F0  * 00000900 ........ //
  BYTE >00,>00,>00,>00,>00,>00,>00,>C0  * 00000908 ........ //
  BYTE >00,>00,>00,>00,>00,>00,>00,>00  * 00000910 ........ //
  BYTE >06,>07,>07,>03,>01,>01,>01,>01  * 00000918 ........ //
  BYTE >00,>00,>80,>80,>07,>03,>44,>80  * 00000920 ......D. //
  BYTE >00,>00,>00,>00,>00,>00,>00,>00  * 00000928 ........ //
  BYTE >00,>00,>00,>00,>00,>00,>00,>00  * 00000930 ........ //
  BYTE >83,>82,>82,>82,>82,>82,>00,>82  * 00000938 ........ //
  BYTE >00,>02,>02,>02,>02,>02,>00,>02  * 00000940 ........ //
  BYTE >83,>02,>02,>02,>02,>02,>83,>80  * 00000948 ........ //
  BYTE >83,>02,>02,>02,>02,>02,>83,>02  * 00000950 ........ //
  BYTE >00,>82,>82,>82,>82,>82,>83,>02  * 00000958 ........ //
  BYTE >83,>80,>80,>80,>80,>80,>83,>02  * 00000960 ........ //
  BYTE >83,>80,>80,>80,>80,>80,>83,>82  * 00000968 ........ //
  BYTE >83,>02,>02,>02,>02,>02,>00,>02  * 00000970 ........ //
  BYTE >83,>82,>82,>82,>82,>82,>83,>82  * 00000978 ........ //
  BYTE >83,>82,>82,>82,>82,>82,>83,>02  * 00000980 ........ //
  BYTE >00,>00,>00,>00,>00,>00,>00,>00  * 00000988 ........ //
  BYTE >00,>00,>00,>00,>00,>00,>00,>00  * 00000990 ........ //
  BYTE >00,>00,>00,>00,>00,>00,>00,>00  * 00000998 ........ //
  BYTE >00,>00,>00,>00,>00,>00,>00,>00  * 000009A0 ........ //
  BYTE >00,>00,>00,>00,>00,>00,>00,>00  * 000009A8 ........ //
  BYTE >00,>00,>00,>00,>00,>00,>00,>00  * 000009B0 ........ //
  BYTE >83,>82,>82,>82,>82,>82,>83,>82  * 000009B8 ........ //
  BYTE >01,>01,>01,>01,>01,>00,>00,>00  * 000009C0 ........ //
  BYTE >03,>01,>18,>60,>0E,>04,>09,>81  * 000009C8 ...`.... //
  BYTE >D0,>80,>D8,>31,>07,>03,>83,>83  * 000009D0 ...1.... //
  BYTE >AA,>C0,>E0,>30,>81,>80,>1C,>F0  * 000009D8 ...0.... //
  BYTE >01,>03,>03,>01,>01,>45,>80,>E0  * 000009E0 .....E.. //
  BYTE >F0,>08,>07,>08,>98,>92,>60,>88  * 000009E8 ......`. //
  BYTE >C4,>51,>07,>07,>07,>F0,>25,>0D  * 000009F0 .Q....%. //
  BYTE >18,>08,>CC,>02,>88,>00,>00,>00  * 000009F8 ........ //
  BYTE >E0,>B0,>40,>00,>00,>00,>00,>80  * 00000A00 ..@..... //
  BYTE >C0,>80,>80,>C0,>F0,>06,>11,>0E  * 00000A08 ........ //
  BYTE >00,>00,>00,>00,>80,>C0,>C0,>38  * 00000A10 .......8 //
  BYTE >01,>01,>01,>00,>1C,>E0,>E0,>E0  * 00000A18 ........ //
  BYTE >83,>03,>81,>80,>80,>80,>40,>80  * 00000A20 ......@. //
  BYTE >00,>00,>00,>C0,>F0,>F0,>07,>03  * 00000A28 ........ //
  BYTE >20,>20,>20,>00,>00,>00,>00,>20  * 00000A30    ....  //
  BYTE >82,>82,>82,>82,>83,>00,>00,>00  * 00000A38 ........ //
  BYTE >02,>02,>02,>02,>00,>00,>00,>00  * 00000A40 ........ //
  BYTE >80,>80,>80,>80,>83,>00,>00,>00  * 00000A48 ........ //
  BYTE >02,>02,>02,>02,>83,>00,>00,>00  * 00000A50 ........ //
  BYTE >02,>02,>02,>02,>00,>00,>00,>00  * 00000A58 ........ //
  BYTE >02,>02,>02,>02,>83,>00,>00,>00  * 00000A60 ........ //
  BYTE >82,>82,>82,>82,>83,>00,>00,>00  * 00000A68 ........ //
  BYTE >02,>02,>02,>02,>00,>00,>00,>00  * 00000A70 ........ //
  BYTE >82,>82,>82,>82,>83,>00,>00,>00  * 00000A78 ........ //
  BYTE >02,>02,>02,>02,>83,>00,>00,>00  * 00000A80 ........ //
  BYTE >00,>00,>00,>00,>00,>00,>00,>00  * 00000A88 ........ //
  BYTE >00,>00,>00,>00,>00,>00,>00,>00  * 00000A90 ........ //
  BYTE >00,>00,>00,>00,>00,>00,>00,>00  * 00000A98 ........ //
  BYTE >00,>00,>00,>00,>00,>00,>00,>00  * 00000AA0 ........ //
  BYTE >00,>00,>00,>00,>00,>00,>00,>00  * 00000AA8 ........ //
  BYTE >00,>00,>00,>00,>00,>00,>00,>00  * 00000AB0 ........ //
  BYTE >82,>82,>82,>82,>83,>00,>00,>00  * 00000AB8 ........ //
  BYTE >00,>00,>00,>01,>01,>01,>01,>01  * 00000AC0 ........ //
  BYTE >E1,>00,>01,>89,>E0,>07,>D0,>01  * 00000AC8 ........ //
  BYTE >C3,>0E,>40,>E2,>0C,>86,>30,>84  * 00000AD0 ..@...0. //
  BYTE >C0,>70,>8C,>C6,>C0,>CC,>04,>04  * 00000AD8 .p...... //
  BYTE >B8,>23,>11,>03,>C6,>70,>10,>83  * 00000AE0 .#...p.. //
  BYTE >C0,>C0,>40,>C0,>C0,>E1,>0E,>A0  * 00000AE8 ..@..... //
  BYTE >C2,>C4,>03,>C4,>8C,>03,>A8,>07  * 00000AF0 ........ //
  BYTE >00,>00,>00,>00,>08,>00,>00,>00  * 00000AF8 ........ //
  BYTE >00,>80,>AA,>80,>2A,>00,>00,>00  * 00000B00 ....*... //
  BYTE >00,>00,>50,>28,>E0,>07,>01,>02  * 00000B08 ..P(.... //
  BYTE >45,>12,>01,>00,>00,>00,>00,>80  * 00000B10 E....... //
  BYTE >E0,>C0,>50,>80,>01,>00,>00,>00  * 00000B18 ..P..... //
  BYTE >00,>00,>00,>00,>00,>00,>00,>00  * 00000B20 ........ //
  BYTE >01,>03,>00,>00,>00,>00,>00,>00  * 00000B28 ........ //
  BYTE >98,>E4,>18,>E4,>E4,>E0,>F0,>00  * 00000B30 ........ //
  BYTE >20,>A1,>21,>23,>C5,>00,>00,>00  * 00000B38  .!#.... //
  BYTE >91,>4A,>44,>E4,>24,>00,>00,>00  * 00000B40 .JD.$... //
  BYTE >88,>44,>88,>45,>8B,>00,>00,>00  * 00000B48 .D.E.... //
  BYTE >06,>88,>04,>02,>8C,>00,>00,>00  * 00000B50 ........ //
  BYTE >9C,>94,>84,>94,>9C,>00,>00,>00  * 00000B58 ........ //
  BYTE >C6,>A5,>46,>A9,>25,>00,>00,>00  * 00000B60 ..F.%... //
  BYTE >C0,>00,>C0,>00,>C0,>00,>00,>00  * 00000B68 ........ //
  BYTE >00,>00,>00,>00,>00,>00,>00,>00  * 00000B70 ........ //
  BYTE >00,>00,>00,>00,>00,>00,>00,>C1  * 00000B78 ........ //
  BYTE >00,>00,>00,>00,>00,>00,>00,>80  * 00000B80 ........ //
  BYTE >00,>00,>00,>00,>00,>00,>00,>0E  * 00000B88 ........ //
  BYTE >00,>00,>00,>00,>00,>00,>00,>C4  * 00000B90 ........ //
  BYTE >00,>00,>00,>00,>00,>00,>00,>38  * 00000B98 .......8 //
  BYTE >00,>00,>00,>00,>00,>00,>00,>B8  * 00000BA0 ........ //
  BYTE >00,>00,>00,>00,>00,>00,>00,>E1  * 00000BA8 ........ //
  BYTE >22,>22,>22,>22,>C5,>00,>00,>0E  * 00000BB0 """".... //
  BYTE >8B,>8A,>AC,>52,>23,>00,>00,>AA  * 00000BB8 ...R#... //
  BYTE >99,>21,>91,>08,>B1,>01,>03,>AA  * 00000BC0 .!...... //
  BYTE >01,>40,>02,>38,>C0,>08,>E0,>F0  * 00000BC8 .@.8.... //
  BYTE >19,>F0,>03,>C1,>01,>2A,>50,>F0  * 00000BD0 .....*P. //
  BYTE >42,>87,>20,>13,>81,>80,>F0,>03  * 00000BD8 B. ..... //
  BYTE >61,>86,>00,>80,>31,>0C,>00,>70  * 00000BE0 a...1..p //
  BYTE >F0,>0C,>02,>E4,>F0,>00,>F0,>83  * 00000BE8 ........ //
  BYTE >07,>58,>07,>07,>87,>07,>07,>08  * 00000BF0 .X...... //
  BYTE >0C,>01,>03,>00,>00,>00,>00,>00  * 00000BF8 ........ //


* Size of data in above array
SIZE_OF_BORDPAT EQU 3072
